## CMakeLists.txt
```
#
# Copyright (c) 2019 Nordic Semiconductor ASA
#
# SPDX-License-Identifier: LicenseRef-BSD-5-Clause-Nordic
#
cmake_minimum_required(VERSION 3.8.2)

#Board selection
#set(BOARD nrf52840dk_nrf52840)
#set(BOARD nrf5340pdk_nrf5340_cpunet)
#set(BOARD nrf5340pdk_nrf5340_cpuapp)
set(BOARD nrf52840dongle_nrf52840)
#set(BOARD nrf52840dk_nrf52811)

find_package(Zephyr REQUIRED HINTS $ENV{ZEPHYR_BASE})
project(NONE)

# Include all files in folder src
FILE(GLOB app_sources_c src/*.c)
FILE(GLOB app_sources_cpp src/*.cpp)

target_sources(app PRIVATE
	${app_sources_c}
	${app_sources_cpp}
	sht3x-5.2.1/hw_i2c/sample-implementations/zephyr_user_space/sensirion_hw_i2c_implementation.c
	sht3x-5.2.1/sensirion_common.c
	sht3x-5.2.1/sht_git_version.c
	sht3x-5.2.1/sht3x.c)
target_include_directories(app PRIVATE include
	sht3x-5.2.1)
```

## prj.conf
```kconfig
#
# Copyright (c) 2019 Nordic Semiconductor ASA
#
# SPDX-License-Identifier: LicenseRef-BSD-5-Clause-Nordic
#
CONFIG_NCS_SAMPLES_DEFAULTS=y

# General configuration
CONFIG_SYSTEM_WORKQUEUE_STACK_SIZE=2048
CONFIG_FLASH=y
CONFIG_FLASH_MAP=y
#CONFIG_FCB=y
CONFIG_NVS=y
CONFIG_SETTINGS=y
CONFIG_HWINFO=y
CONFIG_LOG=y
CONFIG_LOG_PRINTK=y

CONFIG_DK_LIBRARY=y
CONFIG_BT_MESH_DK_PROV=y

# Bluetooth configuration
CONFIG_BT=y
CONFIG_BT_COMPANY_ID=0x0059
CONFIG_BT_DEVICE_NAME="Temp.Hum. Sensor"
CONFIG_BT_L2CAP_RX_MTU=69
CONFIG_BT_L2CAP_TX_MTU=69
CONFIG_BT_L2CAP_TX_BUF_COUNT=8
CONFIG_BT_LL_SW_SPLIT=y
CONFIG_BT_OBSERVER=y
CONFIG_BT_PERIPHERAL=y
CONFIG_BT_SETTINGS=y

# Disable unused Bluetooth features
CONFIG_BT_CTLR_DUP_FILTER_LEN=0
CONFIG_BT_CTLR_LE_ENC=n
CONFIG_BT_DATA_LEN_UPDATE=n
CONFIG_BT_PHY_UPDATE=n
CONFIG_BT_CTLR_CHAN_SEL_2=n
CONFIG_BT_CTLR_MIN_USED_CHAN=n
CONFIG_BT_CTLR_PRIVACY=n

# Bluetooth Mesh configuration
CONFIG_BT_MESH=y
CONFIG_BT_MESH_RELAY=n
CONFIG_BT_MESH_FRIEND=n
CONFIG_BT_MESH_LOW_POWER=y
CONFIG_BT_MESH_LPN_AUTO=y
CONFIG_BT_MESH_LPN_AUTO_TIMEOUT=5
CONFIG_BT_MESH_ADV_BUF_COUNT=13
CONFIG_BT_MESH_TX_SEG_MAX=10
CONFIG_BT_MESH_PB_GATT=y
CONFIG_BT_MESH_GATT_PROXY=n

# Bluetooth Mesh models
CONFIG_BT_MESH_SENSOR_SRV=y

# For NRF Dongle over SWD Flashing
CONFIG_BOARD_HAS_NRF5_BOOTLOADER=y

# I2C SHT3xd Sensor
#CONFIG_STDOUT_CONSOLE=y
CONFIG_I2C=y
CONFIG_NEWLIB_LIBC=n
CONFIG_NEWLIB_LIBC_FLOAT_PRINTF=n
#CONFIG_SENSOR=y
#CONFIG_SHT3XD=y

# Power Managment Device
CONFIG_PM=y
CONFIG_PM_DEEP_SLEEP_STATES=y
CONFIG_PM_STATE_LOCK=y
CONFIG_SERIAL=n
```

## nrf52840dongle_nrf52840.overlay
```dts
&uart0 {
	compatible = "nordic,nrf-uarte";
	status = "disabled";
	current-speed = <115200>;
	tx-pin = <20>;
	rx-pin = <24>;
	rts-pin = <17>;
	cts-pin = <22>;
};

arduino_i2c: &i2c0 {
	compatible = "nordic,nrf-twi";
	status = "okay";
	sda-pin = <20>;
	scl-pin = <22>;
};
```

## src/main.c
```c
#include "bm_config.h"
#include "bm_blemesh.h"
#include "bm_simple_buttons_and_leds.h"
#include <zephyr.h>

/**@brief Function for application main entry.
 */
void main(void) {
  // Start Application
  printk("Starting Application...\n");
  // Init MAC Address
  uint32_t LSB_MAC_Address = NRF_FICR->DEVICEADDR[0];
  printk("Preprogrammed Randomly Static MAC-Address (LSB): 0x%x, %u \n", LSB_MAC_Address, LSB_MAC_Address);
  /* --------------- Init Board ------------*/
	printk("Init Buttons and LEDs...\n");
	bm_init_leds();
	printk("Buttons and LEDs initialized\n");
  printk("Init SHT3xd Sensor\n");

	/* ===================================*/

  // Start Mesh Operation
  bm_blemesh_enable(); // Will return faster than the Stack is realy ready... keep on waiting in the transition.
}
```

## src/bm_blemesh_model_handler.c
```c
/*
This file is part of Bluetooth-Benchamrk.

Bluetooth-Benchamrk is free software: you can redistribute it and/or modify
it under the terms of the GNU General Public License as published by
the Free Software Foundation, either version 3 of the License, or
(at your option) any later version.

Bluetooth-Benchamrk is distributed in the hope that it will be useful,
but WITHOUT ANY WARRANTY; without even the implied warranty of
MERCHANTABILITY or FITNESS FOR A PARTICULAR PURPOSE.  See the
GNU General Public License for more details.

You should have received a copy of the GNU General Public License
along with Bluetooth-Benchamrk.  If not, see <http://www.gnu.org/licenses/>.
*/

/* AUTHOR 	 :    Raffael Anklin       */

/* Pin Assigments: 

| Port.Pin 	| Description
|	P1.10	|	Switch ON/OFF
|	P1.13	|	Signal from Host (1=ON/0=OFF)
|	P1.15	|	Switch Pulse from Host (1s High for Active Switching)

*/

#include "bm_config.h"
#include "bm_simple_buttons_and_leds.h"
#include "bm_blemesh.h"
#include "bm_blemesh_model_handler.h"

#include <bluetooth/bluetooth.h>
#include <bluetooth/mesh/models.h>
#include <bluetooth/mesh/model_types.h>

//#include <device.h>
//#include <drivers/sensor.h>

#include "sht3x.h"

#include <stdio.h>


/** Health Server definition */
static void attention_on(struct bt_mesh_model *model)
{
	printk("attention_on()\n");
}

static void attention_off(struct bt_mesh_model *model)
{
	printk("attention_off()\n");
}
static const struct bt_mesh_health_srv_cb health_srv_cb = {
	.attn_on = attention_on,
	.attn_off = attention_off,
};

static struct bt_mesh_health_srv health_srv = {
	.cb = &health_srv_cb,
};

BT_MESH_HEALTH_PUB_DEFINE(health_pub, 0);


static int rc;
static int32_t temperature, humidity;

// the good stuff
void doubleToSensorValue(double d, struct sensor_value *val) {
  val->val1 = (int)d;
  val->val2 = (d - val->val1) * 1000000;
}

static void temp_hum_get(){
	/* Measure temperature and relative humidity and store into variables
         * temperature, humidity (each output multiplied by 1000).
         */
	rc = sht3x_measure_blocking_read(&temperature, &humidity);
	if (rc == STATUS_OK)
	{
		printf("measured temperature: %0.2f degreeCelsius, "
			   "measured humidity: %0.2f percentRH\n",
			   temperature / 1000.0f, humidity / 1000.0f);
	}
	else
	{
		printf("error reading measurement\n");
	}
}

static int temp_get(struct bt_mesh_sensor *sensor,
					struct bt_mesh_msg_ctx *ctx, struct sensor_value *rsp)
{
	temp_hum_get();
	doubleToSensorValue((double)temperature / 1000,rsp);
	return rc;
}

static int hum_get(struct bt_mesh_sensor *sensor,
					struct bt_mesh_msg_ctx *ctx, struct sensor_value *rsp)
{
	temp_hum_get();
	doubleToSensorValue((double)humidity / 1000,rsp);
	return rc;
}

static struct bt_mesh_sensor temp = {
	.type = &bt_mesh_sensor_present_dev_op_temp,
	.get = temp_get,
};

static struct bt_mesh_sensor hum = {
	.type = &bt_mesh_sensor_present_amb_rel_humidity,
	.get = hum_get,
};

static struct bt_mesh_sensor *const sensors[] = {
	&temp,
	&hum};

static struct bt_mesh_sensor_srv sensor_srv = BT_MESH_SENSOR_SRV_INIT(sensors, ARRAY_SIZE(sensors));

/* Define all Elements */
static struct bt_mesh_elem elements[] = {
	BT_MESH_ELEM(
		1, BT_MESH_MODEL_LIST(BT_MESH_MODEL_CFG_SRV, BT_MESH_MODEL_HEALTH_SRV(&health_srv, &health_pub), BT_MESH_MODEL_SENSOR_SRV(&sensor_srv)),
		BT_MESH_MODEL_NONE)};

/* Create Composition */
static const struct bt_mesh_comp comp = {
	.cid = CONFIG_BT_COMPANY_ID,
	.elem = elements,
	.elem_count = ARRAY_SIZE(elements),
};

const struct bt_mesh_comp *bm_blemesh_model_handler_init(void)
{
	/*
	dev = device_get_binding("SHT3XD");
	if (dev == NULL)
	{
		printf("Could not get SHT3XD device\n");
	}
	*/
	/* Initialize the i2c bus for the current platform */
	sensirion_i2c_init();
	sensirion_i2c_select_bus(0);

	return &comp;
}
```
