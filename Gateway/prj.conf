## CMakeLists.txt
```
# SPDX-License-Identifier: Apache-2.0

cmake_minimum_required(VERSION 3.13.1)

#Board selection
set(BOARD nrf52840dk_nrf52840)
#set(BOARD nrf5340pdk_nrf5340_cpunet)
#set(BOARD nrf5340pdk_nrf5340_cpuapp)
#set(BOARD nrf52840dongle_nrf52840)
#set(BOARD nrf52840dk_nrf52811)

find_package(Zephyr REQUIRED HINTS $ENV{ZEPHYR_BASE})
project(app)

target_sources(app PRIVATE src/main.c src/bm_simple_buttons_and_leds.c src/bm_at_modem.c src/bm_influxdb.c)

target_include_directories(app PRIVATE include)
```

## prj.conf
```kconfig
CONFIG_LOG=y
CONFIG_LOG_DEFAULT_LEVEL=4
# Configuration of influxdb
CONFIG_NEWLIB_LIBC=y
CONFIG_NEWLIB_LIBC_FLOAT_PRINTF=y
CONFIG_NEWLIB_LIBC_NANO=n
# Configuration of the GSM Modem Support
CONFIG_MODEM=y
CONFIG_MODEM_RECEIVER=y
CONFIG_MODEM_IFACE_UART=y
CONFIG_MODEM_CMD_HANDLER=y
CONFIG_MODEM_CONTEXT=y
#CONFIG_MODEM_SOCKET=y
# Config of UART
CONFIG_UART_INTERRUPT_DRIVEN=y
```

## nrf52840dk_nrf52840.overlay
```dts
&uart1 {
	current-speed = <115200>;
	compatible = "nordic,nrf-uarte";
};

/ {
    outputs {
		compatible = "gpio-leds";
		switch: switch_0 {
			gpios = < &gpio1 0xa 0x11 >;
			label = "Switch";
		};
    };
};
```

## src/main.c
```c
#include <zephyr.h>
#include <bm_simple_buttons_and_leds.h>
#include <bm_at_modem.h>
#include <bm_influxdb.h>

#include <stdlib.h>
#include <stdio.h>
#include <string.h>


/**@brief Function for application main entry.
 */
void main(void)
{
  // Start Application
  printk("Starting Application...\n");

  bm_init_leds();
  bm_init_switch();

  init_db();

  static int64_t testval = 42;

  static double testval_2 = 666.69;

  static char testval_s[12] = "Hello 1";

static bool test_bool = true;

  static int64_t ts;

  ts = k_uptime_get();

  begin_meas("name_1","field_1",&testval,int_64,&ts);
  add_fieldset("field_2",&testval_s,string);
  add_tagset("tag_1","hoi");
  add_tagset("tag_2","sali");
  end_meas();

  ts = k_uptime_get();

  for (size_t j = 0; j < 255; j++)
  {
   
 

  for (size_t i = 0; i < 250; i++)
  {
    testval_2 = testval_2 + 1;
    ts = k_uptime_get();
    static char num[6];
    sprintf(num,"%u",(uint16_t)i);
    static char field_1[10];
    memset(field_1,0,sizeof(field_1));
    strcat(field_1,"tst_");
    strcat(field_1,num);
    
    begin_meas("name_2",field_1,&test_bool,boolean,&ts);
    add_fieldset("field_2",&testval_2,float_64);
    add_tagset("tag_1","hoi");
    add_tagset("tag_2","sali");
    end_meas();
    
  }
  




  print_all_meas();

  }

  

  

  

  //bm_at_modem_init();
  
  
}
```

## include/bm_at_modem.h
```c
/*
This file is part of Bluetooth-Benchamrk.

Bluetooth-Benchamrk is free software: you can redistribute it and/or modify
it under the terms of the GNU General Public License as published by
the Free Software Foundation, either version 3 of the License, or
(at your option) any later version.

Bluetooth-Benchamrk is distributed in the hope that it will be useful,
but WITHOUT ANY WARRANTY; without even the implied warranty of
MERCHANTABILITY or FITNESS FOR A PARTICULAR PURPOSE.  See the
GNU General Public License for more details.

You should have received a copy of the GNU General Public License
along with Bluetooth-Benchamrk.  If not, see <http://www.gnu.org/licenses/>.
*/

/* AUTHOR 	 :    Raffael Anklin       */


#ifndef BM_AT_MODEM_H__
#define BM_AT_MODEM_H__



#ifdef __cplusplus
extern "C" {
#endif

/**
 * @brief  Initialize AT Modem
 *
 * @note   Uses Defined UART Interface. 
 */
void bm_at_modem_init();




#ifdef __cplusplus
}
#endif

#endif /* BM_AT_MODEM_H__ */
```

## include/bm_dns.h
```c
/*
This file is part of Bluetooth-Benchamrk.

Bluetooth-Benchamrk is free software: you can redistribute it and/or modify
it under the terms of the GNU General Public License as published by
the Free Software Foundation, either version 3 of the License, or
(at your option) any later version.

Bluetooth-Benchamrk is distributed in the hope that it will be useful,
but WITHOUT ANY WARRANTY; without even the implied warranty of
MERCHANTABILITY or FITNESS FOR A PARTICULAR PURPOSE.  See the
GNU General Public License for more details.

You should have received a copy of the GNU General Public License
along with Bluetooth-Benchamrk.  If not, see <http://www.gnu.org/licenses/>.
*/

/* AUTHOR 	 :    Raffael Anklin       */


#ifndef BM_DNS_H__
#define BM_DNS_H__



#ifdef __cplusplus
extern "C" {
#endif



void bm_dns_do_ipv4_lookup(void);

#ifdef __cplusplus
}
#endif

#endif /* MODEL_HANDLER_H__ */
```

## include/bm_gsm_modem.h
```c
/*
This file is part of Bluetooth-Benchamrk.

Bluetooth-Benchamrk is free software: you can redistribute it and/or modify
it under the terms of the GNU General Public License as published by
the Free Software Foundation, either version 3 of the License, or
(at your option) any later version.

Bluetooth-Benchamrk is distributed in the hope that it will be useful,
but WITHOUT ANY WARRANTY; without even the implied warranty of
MERCHANTABILITY or FITNESS FOR A PARTICULAR PURPOSE.  See the
GNU General Public License for more details.

You should have received a copy of the GNU General Public License
along with Bluetooth-Benchamrk.  If not, see <http://www.gnu.org/licenses/>.
*/

/* AUTHOR 	 :    Raffael Anklin       */


#ifndef BM_GSM_MODEM_H__
#define BM_GSM_MODEM_H__



#ifdef __cplusplus
extern "C" {
#endif



void bm_at_modem_init();

void bm_at_modem_reset();


#ifdef __cplusplus
}
#endif

#endif /* MODEL_HANDLER_H__ */
```

## include/bm_influxdb.h
```c
/*
This file is part of Gateway.

Gateway is free software: you can redistribute it and/or modify
it under the terms of the GNU General Public License as published by
the Free Software Foundation, either version 3 of the License, or
(at your option) any later version.

Gateway is distributed in the hope that it will be useful,
but WITHOUT ANY WARRANTY; without even the implied warranty of
MERCHANTABILITY or FITNESS FOR A PARTICULAR PURPOSE.  See the
GNU General Public License for more details.

You should have received a copy of the GNU General Public License
along with Gateway.  If not, see <http://www.gnu.org/licenses/>.
*/

/* AUTHOR 	 :    Raffael Anklin       */


#ifndef BM_INFLUXDB_H__
#define BM_INFLUXDB_H__



#ifdef __cplusplus
extern "C" {
#endif


#define MAX_LEN_OF_MEASURMENT_UUID 255
#define NUMBER_OF_MEASURMENT_UUIDS 255
#define NUMBER_OF_MEASURMENTS 255
#define MAX_NUMBER_OF_FIELDSETS 2
#define MAX_LEN_OF_FIELD_VALUE 16

/**
 * @brief A Measurment UUID consists of all the metadata fields which have a low cardinality (time invariant).
 * This results in a unique identifier made up by the measurment_name + tags + field_keys. 
 * The field_values are stored in a separate array ordered by the correspondig measurment_uuid[n]. 
 * To find the linked field_values go over the measurment_uuid[n] and sum up the offset:
 * offset = (measurment_uuid[n]->number_of_measurment_links + measurment_uuid[n+1]->number_of_measurment_links + ...).
 *   
 * This way the data with high cardinality (time variant) gets linked to the metadata (measurment_uuids). 
 * It is assumed that there are a low number of uuids and high number of field_values as it should be 
 * in a static enviroment of sensors.
 * 
 * It is assumed that the measurments arrive at a periodic timeline. So when a new measurment arrives the new value gets calculated:
 * avg_time_intervalls[n]_new = avg_time_intervalls[n]_old + ((timestamp - latest_timestamps[n]) - avg_time_intervalls[n]_old) / (number_of_measurment_links[n] + 1)
 * (see: https://math.stackexchange.com/questions/22348/how-to-add-and-subtract-values-from-an-average)
 * 
 * 
 * Measurments are stored in a string, separeted according to InfluxDB Line Protocol. 
 *  see: https://docs.influxdata.com/influxdb/v2.0/reference/syntax/line-protocol/ 
 */
/* ---------- Metadata ------------------- */
extern char measurment_uuids[NUMBER_OF_MEASURMENT_UUIDS][MAX_LEN_OF_MEASURMENT_UUID];
extern uint8_t number_of_measurment_links[NUMBER_OF_MEASURMENT_UUIDS];
extern int64_t avg_time_intervalls[NUMBER_OF_MEASURMENT_UUIDS];
extern int64_t latest_timestamps[NUMBER_OF_MEASURMENT_UUIDS];
/* ---------- Field Values ------------------- */
extern char field_values[MAX_NUMBER_OF_FIELDSETS][NUMBER_OF_MEASURMENTS][MAX_LEN_OF_FIELD_VALUE];
const typedef enum { float_64, int_64, uint_64, string, boolean } field_value_types_t;
/**
 * @brief Begin a measurment with required parameters
 * 
 * @param meas_name String with the name of the Measurment.
 * @param field_key Name describing the field value.
 * @param field_value Field value (see: https://docs.influxdata.com/influxdb/v2.0/reference/syntax/line-protocol/#data-types-and-format).
 * @param field_val_typ Type (see: https://docs.influxdata.com/influxdb/v2.0/reference/syntax/line-protocol/#data-types-and-format).
 * @param timestamp Timestamp in epoch time format (see: https://docs.influxdata.com/influxdb/v2.0/reference/syntax/line-protocol/#unix-timestamp).
 * 
*/
void begin_meas(char *meas_name, char *field_key, void *field_val, field_value_types_t field_val_typ, int64_t *timestamp);
/**
 * @brief Add a tag_set to a previously began measurment
 * 
 * @param tag_key Name describing the tag value.
 * @param tag_value String encoded tag value.
 * 
*/
void add_tagset(char * tag_key, char * tag_value);
/**
 * @brief Add a field_set to a previously began measurment
 * 
 * @param field_key Name describing the field value.
 * @param field_value Field value (see: https://docs.influxdata.com/influxdb/v2.0/reference/syntax/line-protocol/#data-types-and-format).
 * @param field_val_typ Type (see: https://docs.influxdata.com/influxdb/v2.0/reference/syntax/line-protocol/#data-types-and-format).
 * 
*/
void add_fieldset(char *field_key, void *field_value, field_value_types_t field_val_typ);
/**
 * @brief End and store a previously began measurment
 * 
 * @note Save the uuid if not already existent. Update the number of linked measurments. 
 * 
*/
void end_meas();
/**
 * @brief Get all stored measurments to the output stdout. 
 * 
 * @note Could be used to transfer the data.
 * 
*/
void print_all_meas();





#ifdef __cplusplus
}
#endif

#endif /* BM_INFLUXDB_H__ */
```

## include/bm_simple_buttons_and_leds.h
```c
/*
This file is part of Benchamrk-Shared-Library.

Benchamrk-Shared-Library is free software: you can redistribute it and/or modify
it under the terms of the GNU General Public License as published by
the Free Software Foundation, either version 3 of the License, or
(at your option) any later version.

Benchamrk-Shared-Library is distributed in the hope that it will be useful,
but WITHOUT ANY WARRANTY; without even the implied warranty of
MERCHANTABILITY or FITNESS FOR A PARTICULAR PURPOSE.  See the
GNU General Public License for more details.

You should have received a copy of the GNU General Public License
along with Benchamrk-Shared-Library.  If not, see <http://www.gnu.org/licenses/>.
*/

/* AUTHOR ZEPHYR_BLE_MESH  :   Raffael Anklin        */
/* AUTHOR NRF_SDK_ZIGBEE   :   Cyrill Horath        */


#ifdef __cplusplus
extern "C" {
#endif

#ifndef SIMPLE_BUTTONS_AND_LEDS_H
#define SIMPLE_BUTTONS_AND_LEDS_H


#include <zephyr.h>
#include <device.h>
#include <devicetree.h>
#include <devicetree_unfixed.h>
#include <drivers/gpio.h>
#include <sys/util.h>
#include <sys/slist.h>

/*
 * Devicetree helper macro which gets the 'flags' cell from a 'gpios'
 * property, or returns 0 if the property has no 'flags' cell.
 */

#define FLAGS_OR_ZERO(node)						\
	COND_CODE_1(DT_PHA_HAS_CELL(node, gpios, flags),		\
		    (DT_GPIO_FLAGS(node, gpios)),			\
		    (0))



/* The devicetree node identifier for the "led0" alias. */
#define LED0_NODE DT_ALIAS(led0)

#if DT_NODE_HAS_STATUS(LED0_NODE, okay)
#define LED0	DT_GPIO_LABEL(LED0_NODE, gpios)
#define PIN_LED0	DT_GPIO_PIN(LED0_NODE, gpios)
#if DT_PHA_HAS_CELL(LED0_NODE, gpios, flags)
#define FLAGS_LED0	DT_GPIO_FLAGS(LED0_NODE, gpios)
#endif
#else
/* A build error here means your board isn't set up to blink an LED. */
#error "Unsupported board: led0 devicetree alias is not defined"
#define LED0	""
#define PIN_LED0	0
#endif

#ifndef FLAGS_LED0
#define FLAGS_LED0	0
#endif

/* The devicetree node identifier for the "led1" alias. Is the RED LED on THe nRF52 Donlge*/
#define LED1_NODE DT_ALIAS(led1)

#if DT_NODE_HAS_STATUS(LED1_NODE, okay)
#define LED1	DT_GPIO_LABEL(LED1_NODE, gpios)
#define PIN_LED1	DT_GPIO_PIN(LED1_NODE, gpios)
#if DT_PHA_HAS_CELL(LED1_NODE, gpios, flags)
#define FLAGS_LED1	DT_GPIO_FLAGS(LED1_NODE, gpios)
#endif
#else
/* A build error here means your board isn't set up to blink an LED. */
#error "Unsupported board: led1 devicetree alias is not defined"
#define LED1	""
#define PIN_LED1	0
#endif

#ifndef FLAGS_LED1
#define FLAGS_LED1	0
#endif


/* The devicetree node identifier for the "led2" alias. Is the GREEN LED on THe nRF52 Donlge*/
#define LED2_NODE DT_ALIAS(led2)

#if DT_NODE_HAS_STATUS(LED2_NODE, okay)
#define LED2	DT_GPIO_LABEL(LED2_NODE, gpios)
#define PIN_LED2	DT_GPIO_PIN(LED2_NODE, gpios)
#if DT_PHA_HAS_CELL(LED2_NODE, gpios, flags)
#define FLAGS_LED2	DT_GPIO_FLAGS(LED2_NODE, gpios)
#endif
#else
/* A build error here means your board isn't set up to blink an LED. */
#error "Unsupported board: led2 devicetree alias is not defined"
#define LED2	""
#define PIN_LED2	0
#endif

#ifndef FLAGS_LED2
#define FLAGS_LED1	0
#endif

/* The devicetree node identifier for the "led3" alias. Is the BLUE LED on THe nRF52 Donlge*/
#define LED3_NODE DT_ALIAS(led3)

#if DT_NODE_HAS_STATUS(LED3_NODE, okay)
#define LED3	DT_GPIO_LABEL(LED3_NODE, gpios)
#define PIN_LED3	DT_GPIO_PIN(LED3_NODE, gpios)
#if DT_PHA_HAS_CELL(LED3_NODE, gpios, flags)
#define FLAGS_LED3	DT_GPIO_FLAGS(LED3_NODE, gpios)
#endif
#else
/* A build error here means your board isn't set up to blink an LED. */
#error "Unsupported board: led3 devicetree alias is not defined"
#define LED3	""
#define PIN_LED3	0
#endif

#ifndef FLAGS_LED3
#define FLAGS_LED3	0
#endif


/*
 * Get button configuration from the devicetree sw0 alias.
 *
 * At least a GPIO device and pin number must be provided. The 'flags'
 * cell is optional.
 */

#define SW0_NODE	DT_ALIAS(sw0)

#if DT_NODE_HAS_STATUS(SW0_NODE, okay)
#define SW0_GPIO_LABEL	DT_GPIO_LABEL(SW0_NODE, gpios)
#define SW0_GPIO_PIN	DT_GPIO_PIN(SW0_NODE, gpios)
#define SW0_GPIO_FLAGS	(GPIO_INPUT | FLAGS_OR_ZERO(SW0_NODE) | GPIO_INT_DEBOUNCE)
#else
#error "Unsupported board: sw0 devicetree alias is not defined"
#define SW0_GPIO_LABEL	""
#define SW0_GPIO_PIN	0
#define SW0_GPIO_FLAGS	0
#endif


/* The devicetree node identifier for the "switch" node. */
#define SWITCH_NODE DT_NODELABEL(switch)

#if DT_NODE_HAS_STATUS(SWITCH_NODE, okay)
#define SWITCH	DT_GPIO_LABEL(SWITCH_NODE, gpios)
#define PIN_SWITCH	DT_GPIO_PIN(SWITCH_NODE, gpios)
#if DT_PHA_HAS_CELL(SWITCH_NODE, gpios, flags)
#define FLAGS_SWITCH	DT_GPIO_FLAGS(SWITCH_NODE, gpios)
#endif
#else
/* A build error here means your board isn't set up to blink an LED. */
#error "Unsupported board: switch devicetree alias is not defined"
#define SWITCH	""
#define PIN_SWITCH	0
#endif

#ifndef FLAGS_SWITCH
#define FLAGS_SWITCH	0
#endif





/**
* Init the Buttons
*
*/
void bm_init_buttons(void (*button0_cb)());

/**
* Init the Signal
*
*/
void bm_init_signal(void (*signal_cb)());

/**
* Init the Pulse
*
*/
void bm_init_pulse(void (*pulse_cb)());


/**
* Get the BUTTON0 Toggled State
*
* @return State of the BUTTON0 Toggled State (0/1)
*/
bool bm_button0_toggle_state_get();

/**
* Set the BUTTON0 Toggled State
*
* @param State of the BUTTON0 Toggled State (0/1)
*/
void bm_button0_toggle_state_set(bool newstate);



/**
* Init the Leds
*
*/
void bm_init_leds();

/**
* Init the Switch
*
*/
void bm_init_switch();

/**
* Set the LED0 State
*
* @param State to set the LED0 to (0/1) (GREEN no RGB on nRF52 Dongle / LED1 on nRF52 DK)
*/
void bm_led0_set(bool state);

/**
* Get the LED0 State
*
* @return State of the LED0 (0/1) (GREEN no RGB on nRF52 Dongle / LED1 on nRF52 DK)
*/
bool bm_led0_get();


/**
* Set the LED1 State
*
* @param State to set the LED1 to (0/1) (RED on nRF52 Dongle / LED2 on nRF52 DK)
*/
void bm_led1_set(bool state);

/**
* Get the LED1 State
*
* @return State of the LED1 (0/1) (RED on nRF52 Dongle / LED2 on nRF52 DK)
*/
bool bm_led1_get();

/**
* Set the LED2 State
*
* @param State to set the LED2 to (0/1) (GREEN on nRF52 Dongle / LED3 on nRF52 DK)
*/
void bm_led2_set(bool state);

/**
* Get the LED2 State
*
* @return State of the LED2 (0/1) (GREEN on nRF52 Dongle / LED3 on nRF52 DK)
*/
bool bm_led2_get();

/**
* Set the LED3 State
*
* @param State to set the LED3 to (0/1) (BLUE on nRF52 Dongle / LED4 on nRF52 DK)
*/
void bm_led3_set(bool state);

/**
* Get the LED3 State
*
* @return State of the LED3 (0/1) (BLUE on nRF52 Dongle / LED4 on nRF52 DK)
*/
bool bm_led3_get();

/**
* Set the Switch State
*
* @param State to set the Switch to (0/1) 
*/
void bm_switch_set(bool state);

/**
* Get the SWITCH State
*
* @return State of the SWITCH (0/1)
*/
bool bm_switch_get();

#endif

#ifdef __cplusplus
}
#endif
```

## include/bm_sponge.h
```c
/*
This file is part of Gateway.

Gateway is free software: you can redistribute it and/or modify
it under the terms of the GNU General Public License as published by
the Free Software Foundation, either version 3 of the License, or
(at your option) any later version.

Gateway is distributed in the hope that it will be useful,
but WITHOUT ANY WARRANTY; without even the implied warranty of
MERCHANTABILITY or FITNESS FOR A PARTICULAR PURPOSE.  See the
GNU General Public License for more details.

You should have received a copy of the GNU General Public License
along with Gateway.  If not, see <http://www.gnu.org/licenses/>.
*/

/* AUTHOR 	 :    Raffael Anklin       */


#ifndef BM_SPONGE_H__
#define BM_SPONGE_H__



#ifdef __cplusplus
extern "C" {
#endif

#include <bm_influxdb.h>

#define PUSH_INTERVALL_SECONDS 60
#define SYNC_INTERVALL_SECONDS 600


/**
 * @brief Sponge is a transportprotocol for influxdb data. It is designed to have a small payload size with a tradeoff in a higher latency. 
 * 
 * The Spongeserver pushes the field_values on a regular timebase (push_intervall). The Spongeclient receives the field_values and combines them 
 * with the corresponding metadata, reconstructs the timestamps and is able to push the whole measurments to a infludb instance.
 * A synchronisation handshake is done on a regular timebase (sync_intervall) where the Server rerports to the client the metadata.
 *  
 * It is assumed that the measurment_uuids and time_intervalls are more or less constant (time invariant), so after a initial sync
 * only the checksum of them is compared during the sync handshake. If they mismatch they are retransmitted immediatly.
 * 
 * When a push_intervall is triggered, the server does:
 * -- Delta encode all data fields.
 * -- Encode Protobuf Message.
 * -- Send the Data to the Client.
* When a sync_intervall is triggered, the server does:
 * -- Calculate the 
 * The CLient does:
 * -- Listen for incoming push / sync messages
 * If push_message:
 * -- Decode Protobuf Message
 * -- Delta Decode all data fields
 * -- Restore Timestamps **
 * -- Publish Data to influxdb
 * 
 */

/**
 * @brief Delta Encode Field Values
 * 
 * @note To Compress the Sizes for transport is over
 * 
*/
void delta_encode_all_meas();
/**
 * @brief Delta decode Field Values 
 * 
 * @note To restore Field Values
 * 
*/
void delta_decode_all_meas();


#ifdef __cplusplus
}
#endif

#endif /* BM_SPONGE_H__ */
```

## src/bm_at_modem.c
```c
/* Uses AT-Interface to send data over UDP, resolve dns and send a sms in regular intervalls */

#include <zephyr.h>
#include <device.h>
#include <drivers/uart.h>
#include <sys/printk.h>
#include <../drivers/modem/modem_receiver.h>
#include <logging/log.h>
LOG_MODULE_REGISTER(bm_at_modem);
#include <stdlib.h>
#include <stdio.h>
#include <bm_simple_buttons_and_leds.h>

#define MODEM_UART_DEV_NAME "UART_1"
#define RX_BUF_LEN 255
#define TX_BUF_LEN 255

struct mdm_receiver_context ctx;

uint8_t rx_buf[RX_BUF_LEN];
uint8_t rx_ring_buf[RX_BUF_LEN];
size_t rx_len = RX_BUF_LEN;

uint8_t tx_buf[TX_BUF_LEN];
size_t tx_len = TX_BUF_LEN;

struct uart_config uart_conf = {
	.baudrate = 115200,
	.parity = UART_CFG_PARITY_NONE,
	.stop_bits = UART_CFG_STOP_BITS_1,
	.data_bits = UART_CFG_DATA_BITS_8,
	.flow_ctrl = UART_CFG_FLOW_CTRL_NONE};

int Guthaben_Fr;
int Guthaben_Rp;

int Daten_MB;
int Daten_KB;

char ip[15];

/**
 * @brief  Send a AT Cmd and check response
 * 
 * @param cmd AT Command String (AT+...)
 * @param waittime_ms Waittime until checking for rsp_substr in Response Buffer
 * @param rsp_substr Search for this substring in Response after waittime_ms
 * @param reset_modul_on_fail Search for this substring in Response after waittime_ms
 * 
 * @return 1 if Response Substring was found, otherwise 0 
 * 
 */
bool bm_at_modem_send_cmd(const char *cmd, uint32_t waittime_ms, const char *rsp_substr)
{
	static int ret;
	static size_t bytes_read;
	strcpy(tx_buf, cmd);
	if (!ring_buf_is_empty(&ctx.rx_rb))
	{
		ring_buf_reset(&ctx.rx_rb);
	}
	ret = mdm_receiver_send(&ctx, tx_buf, strlen(tx_buf));
	k_sleep(K_MSEC(waittime_ms));
	mdm_receiver_recv(&ctx, rx_buf, rx_len, &bytes_read);
	if (bytes_read > 0)
	{
		rx_buf[bytes_read] = '\0';
		LOG_DBG("%s", log_strdup((char *)rx_buf));
		if (strstr((char *)rx_buf, rsp_substr) != NULL)
		{
			return 1;
		}
		else
		{
			return 0;
		}
	}
	else
	{
		return 0;
	}
}

/**
 * @brief  Reset Modem 
 *
 * @note   Should be done in case of a error and in the beginning
 */
void bm_at_modem_reset()
{
	//Check that Modem is Responding
	static bool OK = false;
	bm_switch_set(false); //Turn Off PWR Key
	while (!OK){
		OK = bm_at_modem_send_cmd("AT\r\0", 1000, "OK");		   //AT
		if (!OK){
			bm_led1_set(!bm_led1_get()); //Toogle Red LED
			bm_switch_set(!bm_switch_get()); //Toogle PWR Key
		}
	}
	bm_switch_set(true); //Turn On PWR Key
	bm_led1_set(false); //Turn off Red LED
	bm_at_modem_send_cmd("AT+CFUN=1,1\r\0", 7000, "SMS Ready");	//Reset Modul
	bm_at_modem_send_cmd("AT+CPIN?\r\0", 1000, "+CPIN:READY");		//Check SIM Status
	bm_at_modem_send_cmd("AT+CSQ\r\0", 1000, "+CSQ:");				//Check RF Signal
	bm_at_modem_send_cmd("AT+CGATT?\r\0", 1000, "+CGATT: 1");		//Check PS service. 1 indicates PS has attached:
	bm_at_modem_send_cmd("AT+COPS?\r\0", 1000, "+COPS:");			//Query Network information, operator and network.
	bm_at_modem_send_cmd("AT+CGNAPN\r\0", 1000, "+CGNAPN: 1");		//Query the APN delivered by the network after the CAT-M or NB-IOT network is successfully registered.
	bm_at_modem_send_cmd("AT+CNACT=0,1\r\0", 5000, "+APP PDP: 0,ACTIVE");	//Activate network, Activate 0th PDP.
}

/**
 * @brief  Send a SMS "Status" to 444 
 *
 * @note   To keep PrePaid Mobile NUmber Active Should be called once a month. Also usefull to inspect used Data Volume. 
 */
void bm_at_modem_send_status_sms()
{
	bm_at_modem_send_cmd("AT+CMGD=0,4\r\0", 1000, "OK");		   //Delete all SMS
	bm_at_modem_send_cmd("AT+CSMS=0\r\0", 1000, "+CSMS: 1,1,1");   //Select message service
	bm_at_modem_send_cmd("AT+CMGF=1\r\0", 1000, "OK");			   // Set SMS Text Mode
	bm_at_modem_send_cmd("AT+CMGS=\"444\"\r\0", 1000, ">");		   //Setup SMS to 444
	bm_at_modem_send_cmd("Status\x1A\0", 3000, "+CMTI: \"SM\",0"); //Send SMS with text Status (CTRL+Z) = \1xA
	bm_at_modem_send_cmd("AT+CMGR=0\r\0", 5000, "+CMGR: \"REC");   //Read SMS
	// Get Guthaben Fr.
	static char * begin;
	static char * middle;
	static char * end;
	begin = strstr((char *)rx_buf, "CHF ");
	middle = strstr(begin, ".");
	end = strstr(middle, ". Daten");
	if ((begin != NULL) && (middle != NULL) && (end != NULL) && ((end - begin - 4)<=10))
	{
		static char substr_tmp[10];
		memcpy(&substr_tmp,"\0\0\0\0\0\0\0\0\0",10); // Reset tmp
		memcpy(&substr_tmp,begin + 4,middle - begin + 4);
		Guthaben_Fr = atoi(substr_tmp);
		memcpy(&substr_tmp,"\0\0\0\0\0\0\0\0\0",10); // Reset tmp
		memcpy(&substr_tmp,middle + 1,end - middle + 1);
		Guthaben_Rp = atoi(substr_tmp) * 10;
	}
	// Get Daten MB
	begin = strstr((char *)rx_buf, "Schweiz: ");
	middle = strstr(begin, ".");
	end = strstr(middle, " MB");
	if ((begin != NULL) && (middle != NULL) && (end != NULL) && ((end - begin - 9)<=10))
	{
		static char substr_tmp[10];
		memcpy(&substr_tmp,"\0\0\0\0\0\0\0\0\0",10); // Reset tmp
		memcpy(&substr_tmp,begin + 9,middle - begin + 9);
		Daten_MB = atoi(substr_tmp);
		memcpy(&substr_tmp,"\0\0\0\0\0\0\0\0\0",10); // Reset tmp
		memcpy(&substr_tmp,middle + 1,end - middle + 1);
		Daten_KB = atoi(substr_tmp);
	}
	bm_at_modem_send_cmd("AT+CMGD=0,4\r\0", 1000, "OK"); //Delete all SMS
	printk("Guthaben: %d.%d CHF\n",Guthaben_Fr,Guthaben_Rp);
	printk("Daten: %d.%d MB\n",Daten_MB,Daten_KB);
}




/**
 * @brief  DNS Request 
 *
 * @note   Issue a DNS Request
 */
void bm_at_modem_dns_query(const char *domain)
{
	bm_at_modem_send_cmd("AT+CDNSPDPID=0\r\0", 1000, "OK");			//Select PDP Index for DNS
	static char dns_cmd[50];
	strcpy(dns_cmd,  "AT+CDNSGIP=\"");
	strcat(dns_cmd, domain);
	strcat(dns_cmd, "\",1,1000\r\0");
	bm_at_modem_send_cmd(dns_cmd, 5000, "+CDNSGIP: 1");	//DNS Request:
	// Get IP
	static char * begin;
	static char * end;
	begin = strstr((char *)rx_buf, "\",\"");
	end = strstr(begin+3, "\"");
	if ((begin != NULL)  && (end != NULL) && ((end - begin - 3)<=15))
	{
		memcpy(&ip,"\0\0\0\0\0\0\0\0\0\0\0\0\0\0",15); // Reset tmp
		memcpy(&ip, begin + 3,end - begin - 3);
		LOG_DBG("IP: %s", log_strdup((char *)ip));
	} else {
		bm_at_modem_reset();
	}
}


/**
 * @brief  Send UDP Data 
 *
 * @note   Send fixed size UDP Data. Send to Previously Queried IP Address on fixed Port
 */
void bm_at_modem_udp_send(char * data)
{
	bm_at_modem_send_cmd("AT+CNACT?\r\0", 1000, "+CNACT:");			//Check the 0th PDN/PDP local IP
	static char caopen_cmd[50];
	memset(caopen_cmd,0,sizeof(caopen_cmd)); // Reset
	strcpy(caopen_cmd,  "AT+CAOPEN=0,0,\"UDP\",\"");
	strcat(caopen_cmd, ip);
	strcat(caopen_cmd, "\",63521\r\0");
	bm_at_modem_send_cmd(caopen_cmd, 5000, "+CAOPEN: 0,0");	 //Create a UDP connection with 0th PDP on 0th connection.
	memset(caopen_cmd,0,sizeof(caopen_cmd)); // Reset
	strcpy(caopen_cmd,  "AT+CASEND=0,");
	static char num[8];
	memset(num,0,sizeof(num)); // Reset
	sprintf(num,"%d",strlen(data));
	strcat(caopen_cmd, num);
	strcat(caopen_cmd, "\r\0");
	bm_at_modem_send_cmd(caopen_cmd, 1000, "OK");			//Request to send 5 bytes of data
	bm_at_modem_send_cmd(data, 2000, "OK");	 //Create a UDP connection with 0th PDP on 0th connection.
	bm_at_modem_send_cmd("AT+CACLOSE=0\r\0", 1000, "OK");			//Close the connection with an identifier of 0.
	
}




/**
 * @brief  Initialize AT Modem
 *
 * @note   Uses Defined UART Interface. 
 */
void bm_at_modem_init()
{
	static int ret;

	ctx.uart_dev = device_get_binding(MODEM_UART_DEV_NAME);
	ret = uart_configure(ctx.uart_dev, &uart_conf);
	LOG_DBG("Init UART returned code: %d", ret);

	ret = mdm_receiver_register(&ctx, MODEM_UART_DEV_NAME, rx_ring_buf, rx_len);
	LOG_DBG("Init AT Modem returned code: %d", ret);

	bm_at_modem_reset();

	bm_at_modem_dns_query("home.villa28.ch");

	bm_at_modem_send_status_sms();

	bm_at_modem_udp_send("Hoi Du Geili Sau :) @BFF");



}
```

## src/bm_cmmp.c
```c
/* CMMP = Compressed Metrics Metadata Protocol */

#include <zephyr.h>
#include <sys/printk.h>
#include <logging/log.h>
LOG_MODULE_REGISTER(bm_influxdb);
#include <bm_influxdb.h>
#include <stdlib.h>
#include <stdio.h>
#include <string.h>



/**
 * @brief  Get the Measurment Index by its name
 * 
 * @param name Name of the measurment
 * 
 * @return index of Array if found. -1 if not found 
 * 
 */
int get_meas_from_name(char * name){
	for (int i = 0; i < NUMBER_OF_MEASURMENTS; i++)
	{
		if (strcmp(name,measurments[i].measurment_name)==0)
		{
			return i;
		}		
	}
	return -1;	
}
```

## src/bm_dns.c
```c
#include <logging/log.h>
LOG_MODULE_REGISTER(bm_dns, LOG_LEVEL_DBG);

#include <zephyr.h>
#include <linker/sections.h>
#include <errno.h>
#include <stdio.h>

#include <net/net_core.h>
#include <net/net_if.h>
#include <net/net_mgmt.h>
#include <net/dns_resolve.h>

#define DNS_TIMEOUT (2 * MSEC_PER_SEC)


void dns_result_cb(enum dns_resolve_status status,
		   struct dns_addrinfo *info,
		   void *user_data)
{
	char hr_addr[NET_IPV6_ADDR_LEN];
	char *hr_family;
	void *addr;

	switch (status) {
	case DNS_EAI_CANCELED:
		LOG_INF("DNS query was canceled");
		return;
	case DNS_EAI_FAIL:
		LOG_INF("DNS resolve failed");
		return;
	case DNS_EAI_NODATA:
		LOG_INF("Cannot resolve address");
		return;
	case DNS_EAI_ALLDONE:
		LOG_INF("DNS resolving finished");
		return;
	case DNS_EAI_INPROGRESS:
		break;
	default:
		LOG_INF("DNS resolving error (%d)", status);
		return;
	}

	if (!info) {
		return;
	}

	if (info->ai_family == AF_INET) {
		hr_family = "IPv4";
		addr = &net_sin(&info->ai_addr)->sin_addr;
	} else if (info->ai_family == AF_INET6) {
		hr_family = "IPv6";
		addr = &net_sin6(&info->ai_addr)->sin6_addr;
	} else {
		LOG_ERR("Invalid IP address family %d", info->ai_family);
		return;
	}

	LOG_INF("%s %s address: %s", user_data ? (char *)user_data : "<null>",
		hr_family,
		log_strdup(net_addr_ntop(info->ai_family, addr,
					 hr_addr, sizeof(hr_addr))));
}


void bm_dns_do_ipv4_lookup(void)
{
	static const char *query = "www.zephyrproject.org";
	static uint16_t dns_id;
	int ret;

	ret = dns_get_addr_info(query,
				DNS_QUERY_TYPE_A,
				&dns_id,
				dns_result_cb,
				(void *)query,
				DNS_TIMEOUT);
	if (ret < 0) {
		LOG_ERR("Cannot resolve IPv4 address (%d)", ret);
		return;
	}

	LOG_DBG("DNS id %u", dns_id);
}
```

## src/bm_gsm_modem.c
```c
#include <zephyr.h>
#include <device.h>
#include <sys/printk.h>
#include <console/tty.h>

#define RX_BUFFER_SIZE 512
#define TX_BUFFER_SIZE 512
#define UART_DEV_NAME "UART_1"

const struct device *uart_dev;
struct tty_serial* tty_dev;
static uint8_t rx_buf[RX_BUFFER_SIZE];
static uint8_t tx_buf[TX_BUFFER_SIZE];

void bm_gsm_modem_reset()
{

	//Reset Funktion
	//tx_buf = "AT\r";
	tty_write(tty_dev,"AT\r",3);
	//tty_write(tty_dev,tx_buf,TX_BUFFER_SIZE);
	//Wait for connected (Event)
}

void bm_gsm_modem_connect()
{

	//Reset Modul
	//char tx[11] = "AT+CFUN=1,1";
	/*
	char tx[3] = "AT\r";
	int ret;
	
	ret = uart_tx(uart_dev, &tst, 1, SYS_FOREVER_MS);
	printk("Returned %d", ret);
	*/

}

void bm_gsm_modem_disconnect()
{

	//gsm_ppp_stop(gsm_dev);
	//Wait for disconnected (Event)
}

void bm_gsm_modem_init()
{
	uart_dev = device_get_binding(UART_DEV_NAME);
	tty_init(tty_dev,uart_dev);
	//tty_dev->uart_dev = uart_dev;
	//tty_set_rx_buf(tty_dev,rx_buf,RX_BUFFER_SIZE);
	//tty_set_tx_buf(tty_dev,tx_buf,TX_BUFFER_SIZE);

	
}
```

## src/bm_influxdb.c
```c
/* Influxdb Measurments */

#include <zephyr.h>
#include <sys/printk.h>
#include <logging/log.h>
LOG_MODULE_REGISTER(bm_influxdb);
#include <bm_influxdb.h>
#include <stdlib.h>
#include <stdio.h>
#include <string.h>
#include <inttypes.h>

/* ---------- Metadata ------------------- */
char measurment_uuids[NUMBER_OF_MEASURMENT_UUIDS][MAX_LEN_OF_MEASURMENT_UUID];
bool measurment_uuids_free[NUMBER_OF_MEASURMENT_UUIDS];
uint8_t number_of_measurment_links[NUMBER_OF_MEASURMENT_UUIDS];
int64_t avg_time_intervalls[NUMBER_OF_MEASURMENT_UUIDS];
int64_t latest_timestamps[NUMBER_OF_MEASURMENT_UUIDS];
/* ---------- Field Values ------------------- */
char field_values[MAX_NUMBER_OF_FIELDSETS][NUMBER_OF_MEASURMENTS][MAX_LEN_OF_FIELD_VALUE];
bool field_values_free[NUMBER_OF_MEASURMENTS];
uint16_t field_values_metalink[NUMBER_OF_MEASURMENTS]; //Dont match default value 0
bool field_values_metalink_free[NUMBER_OF_MEASURMENTS];
/* ----------- Timestamps ---------------- */
int64_t timestamps[NUMBER_OF_MEASURMENTS];

/* Helper Pointers */
int measurment_uuid_cnt; //Points to next free measurment_uuid -> Needs Reset Upon Clearing

/* Buffer to enque new measurments */
char measurment_uuid_buf[MAX_LEN_OF_MEASURMENT_UUID];
char field_values_buf[MAX_NUMBER_OF_FIELDSETS][MAX_LEN_OF_FIELD_VALUE];
int field_values_buf_cnt; // POints to next free location
int64_t timestamp_buf;
K_SEM_DEFINE(measurments_buffer_sem, 1, 1);
K_SEM_DEFINE(measurments_sem, 1, 1);
char *begin;

void init_db(){
	//Reset all FIleds
	memset(measurment_uuids_free,true,sizeof(measurment_uuids_free));
	memset(field_values_free,true,sizeof(field_values_free));
	memset(field_values_metalink,NUMBER_OF_MEASURMENT_UUIDS + 1,sizeof(field_values_metalink));
	memset(field_values_metalink_free,true,sizeof(field_values_metalink_free));
}

void set_field_val(void *field_val, field_value_types_t field_val_typ)
{
	//Set field_val according to type
	switch (field_val_typ)
	{
	case float_64:
		sprintf(field_values_buf[field_values_buf_cnt], "%lf", *(double *)field_val);
		break;
	case int_64:
		sprintf(field_values_buf[field_values_buf_cnt], "%llii", *(int64_t *)field_val);
		break;
	case uint_64:
		sprintf(field_values_buf[field_values_buf_cnt], "%lluu", *(uint64_t *)field_val);
		break;
	case string:
		strcat(field_values_buf[field_values_buf_cnt], "\"");
		strcat(field_values_buf[field_values_buf_cnt], field_val);
		strcat(field_values_buf[field_values_buf_cnt], "\"");
		break;
	case boolean:
		if (*(bool *)field_val == true)
		{
			strcat(field_values_buf[field_values_buf_cnt], "t");
		}
		else
		{
			strcat(field_values_buf[field_values_buf_cnt], "f");
		}
		break;
	default:
		break;
	}
}

void begin_meas(char *meas_name, char *field_key, void *field_val, field_value_types_t field_val_typ, int64_t *timestamp)
{
	// Check if new tagset doesnt overfit the uuid field with strlen...
	// Check if field_val_len < MAX_LEN_OF_FIELD_VALUE
	/* Safe parameters in buffer */
	if (k_sem_take(&measurments_buffer_sem, K_MSEC(1000)) != 0)
	{
		LOG_ERR("Unable to create new measurment! Buffer in use.");
		return;
	}
	memset(measurment_uuid_buf, 0, sizeof(measurment_uuid_buf)); // Reset Buffer
	memset(field_values_buf, 0, sizeof(field_values_buf));		 // Reset Buffer
	field_values_buf_cnt = 0;									 // Reset Counter
	strcat(measurment_uuid_buf, meas_name);
	strcat(measurment_uuid_buf, ", ");
	strcat(measurment_uuid_buf, field_key);
	strcat(measurment_uuid_buf, "=");
	static char num[6];
	sprintf(num, "%u", field_values_buf_cnt);
	strcat(measurment_uuid_buf, num);
	strcat(measurment_uuid_buf, " ");
	set_field_val(field_val, field_val_typ);
	field_values_buf_cnt = field_values_buf_cnt + 1;
	timestamp_buf = *timestamp;
};

void add_tagset(char *tag_key, char *tag_value)
{
	// Check if new tagset doesnt overfit the uuid field with strlen...

	begin = strstr(measurment_uuid_buf, ",");
	if (begin == NULL)
	{
		LOG_ERR("Unable to create new tagset! No began measurment found");
		return;
	}
	// Insert new tagset
	begin = begin + sizeof(",") - 1;
	static int x;
	static char tmp[MAX_LEN_OF_MEASURMENT_UUID];
	memset(tmp, 0, sizeof(tmp));
	x = begin - measurment_uuid_buf;
	strncpy(tmp, measurment_uuid_buf, x);
	strncpy(&tmp[x], "\0", 1);
	strcat(tmp, tag_key);
	strcat(tmp, "=");
	strcat(tmp, tag_value);
	//if (strncmp(&measurment_uuid_buf[x+1]," ",1) != 0)
	if (measurment_uuid_buf[x] != " "[0])
	{
		//Comma betweeen tagsets
		strcat(tmp, ",");
	}
	strcat(tmp, measurment_uuid_buf + x);
	strcpy(measurment_uuid_buf, tmp);
};

void add_fieldset(char *field_key, void *field_value, field_value_types_t field_val_typ)
{
	//Check that there is mor fileds allowed
	if (field_values_buf_cnt >= MAX_NUMBER_OF_FIELDSETS)
	{
		LOG_ERR("Unable to create new fieldset! MAX_NUMBER_OF_FIELDSETS reached");
		return;
	}
	// Check if new fieldset doesnt overfit the uuid field with strlen...

	begin = strstr(measurment_uuid_buf, " ");
	if (begin == NULL)
	{
		LOG_ERR("Unable to create new fieldset! No began measurment found");
		return;
	}
	// Insert new fieldset
	begin = begin + sizeof(" ") - 1;
	static int x;
	static char tmp[MAX_LEN_OF_MEASURMENT_UUID];
	memset(tmp, 0, sizeof(tmp));
	x = begin - measurment_uuid_buf;
	strncpy(tmp, measurment_uuid_buf, x);
	strncpy(&tmp[x], "\0", 1);
	strcat(tmp, field_key);
	strcat(tmp, "=");
	static char num[6];
	sprintf(num, "%u", field_values_buf_cnt);
	strcat(tmp, num);
	strcat(tmp, ",");
	strcat(tmp, measurment_uuid_buf + x);
	strcpy(measurment_uuid_buf, tmp);
	set_field_val(field_value, field_val_typ);
	field_values_buf_cnt = field_values_buf_cnt + 1;
};

void end_meas()
{
	//Get Metadata Position
	static int meas_ptr;
	//Get Measurment UUID Index
	for (size_t i = 0; i < NUMBER_OF_MEASURMENT_UUIDS; i++)
	{
		if ((strcmp(measurment_uuids[i], measurment_uuid_buf) == 0) || measurment_uuids_free[i] == true)
		{
			meas_ptr = i;
			break;
		}
	}
	//Check there is space available
	if (measurment_uuid_cnt >= MAX_LEN_OF_MEASURMENT_UUID)
	{
		LOG_ERR("Unable to append new measurment_uuid! MAX_LEN_OF_MEASURMENT_UUID reached");
		k_sem_give(&measurments_buffer_sem);
		return;
	}
	//Request Access
	if (k_sem_take(&measurments_sem, K_MSEC(1000)) != 0)
	{
		LOG_ERR("Unable to append new measurment! Data in use.");
		k_sem_give(&measurments_buffer_sem);
		return;
	}
	// Create UUID
	if (measurment_uuids_free[meas_ptr] == true)
	{
		strcpy(measurment_uuids[meas_ptr], measurment_uuid_buf); //Copy uuid
		measurment_uuids_free[meas_ptr] = false;
	}
	//Update intervall
	if (latest_timestamps[meas_ptr] != 0)
	{
		static uint64_t s;
		s = avg_time_intervalls[meas_ptr];
		avg_time_intervalls[meas_ptr] = s + ((timestamp_buf - latest_timestamps[meas_ptr]) - s) / (number_of_measurment_links[meas_ptr] + 1);
		// see: https://math.stackexchange.com/questions/22348/how-to-add-and-subtract-values-from-an-average
	}
	//Update number of linkes
	number_of_measurment_links[meas_ptr] = number_of_measurment_links[meas_ptr] + 1;
	//Update latest timestamp
	latest_timestamps[meas_ptr] = timestamp_buf;
	//Save value field and timestamp
	for (size_t i = 0; i < NUMBER_OF_MEASURMENTS; i++)
	{
		if ((field_values_metalink[i] == meas_ptr || field_values_metalink_free[i] == true) && field_values_free[i] == true)
		{
			for (size_t j = 0; j < field_values_buf_cnt; j++)
			{
				memcpy(field_values[j][i], field_values_buf[j], MAX_LEN_OF_FIELD_VALUE); //Copy content
			}
			timestamps[i] = timestamp_buf;
			field_values_metalink[i] = meas_ptr;
			field_values_metalink_free[i] = false;
			field_values_free[i] = false;
			break;
		}
	}
	k_sem_give(&measurments_buffer_sem);
	k_sem_give(&measurments_sem);
};

void print_all_meas()
{
	static char buf[MAX_LEN_OF_MEASURMENT_UUID + MAX_LEN_OF_FIELD_VALUE * MAX_NUMBER_OF_FIELDSETS]; // Calculate the MAximum allowed size
	static char *begin_fieldset;
	static char *begin_fieldvalue;
	static int len;
	for (size_t i = 0; i < NUMBER_OF_MEASURMENTS; i++)
	{
		//CHeck if end ist reached by getting to first free field
		if(field_values_free[i] || field_values_metalink_free[i]){
			break;
		}
		static uint32_t j;
		j = field_values_metalink[i];
		//Reset buffer
		memset(buf, 0, sizeof(buf));
		//Get Beginning of Fieldsets
		begin_fieldset = strstr(measurment_uuids[j], " ");
		if (begin_fieldset == NULL)
		{
			//LOG_ERR("Unable to find fieldset! Measurment UUID Corrupt");
			break;
		}
		begin_fieldset = begin_fieldset + sizeof(" ") - 1;
		//Append till fieldset
		len = begin_fieldset - measurment_uuids[j];
		strncat(buf, measurment_uuids[j], len);
		//Get all the fieldsets
		while (strstr(begin_fieldset, "=") != NULL)
		{
			//Get Beginning of fieldvalue
			begin_fieldvalue = strstr(begin_fieldset, "=");
			if (begin_fieldvalue == NULL)
			{
				//LOG_ERR("Unable to find filedvalue! Measurment UUID Corrupt");
				break;
			}
			begin_fieldvalue = begin_fieldvalue + sizeof("=") - 1;
			//Get the field_value index
			static int ind;
			ind = atoi(begin_fieldvalue);
			//Append field_key
			len = begin_fieldvalue - begin_fieldset;
			strncat(buf, begin_fieldset, len);
			//Add fieldvalue
			strcat(buf, field_values[ind][i]);
			//Get next fieldset
			begin_fieldset = strstr(begin_fieldvalue, ",");
			if (begin_fieldset == NULL)
			{
				break;
			}
		}
		//Whtiespace
		strcat(buf, " ");
		//Add Timestamp
		static char ts[16];
		sprintf(ts, "%lli", timestamps[i]);
		strcat(buf, ts);
		//Output Measurment
		printk("%s\n", buf);
	}
	//Free all Measurments
	memset(field_values_free, true, sizeof(field_values_free));
}
```

## src/bm_simple_buttons_and_leds.c
```c
/*
This file is part of Benchmark-Shared-Library.

Benchmark-Shared-Library is free software: you can redistribute it and/or modify
it under the terms of the GNU General Public License as published by
the Free Software Foundation, either version 3 of the License, or
(at your option) any later version.

Benchmark-Shared-Library is distributed in the hope that it will be useful,
but WITHOUT ANY WARRANTY; without even the implied warranty of
MERCHANTABILITY or FITNESS FOR A PARTICULAR PURPOSE.  See the
GNU General Public License for more details.

You should have received a copy of the GNU General Public License
along with Benchmark-Shared-Library.  If not, see <http://www.gnu.org/licenses/>.
*/

/* AUTHOR ZEPHYR_BLE_MESH  :   Raffael Anklin        */
/* AUTHOR NRF_SDK_ZIGBEE   :   Cyrill Horath        */

#include "bm_simple_buttons_and_leds.h"


const struct device *dev_led0, *dev_led1, *dev_led2, *dev_led3, *dev_button0, *dev_switch;
bool led0_is_on, led1_is_on, led2_is_on, led3_is_on, switch_is_on = true;
bool button0_toggel_state = true;
int ret;

static struct gpio_callback button_cb_data;

static struct k_work_delayable buttons_debounce;

static void (*button0_callback)();

static void buttons_debounce_fn(struct k_work *work) {
  button0_toggel_state = !button0_toggel_state;
  button0_callback();
}


void button_pressed(const struct device *port,
					struct gpio_callback *cb,
					gpio_port_pins_t pins) {
  if (port == dev_button0) {
    k_work_reschedule(&buttons_debounce, K_MSEC(170)); // Debounce the Button
                                                           //button0_callback();
  }
  //printk("Button pressed at %" PRIu32 "\n", k_cycle_get_32());
}

gpio_callback_handler_t button_pressed_handler = &button_pressed;


/* Init the Buttons */
void bm_init_buttons(void (*button0_cb)()) {
  dev_button0 = device_get_binding(SW0_GPIO_LABEL);
  if (dev_button0 == NULL) {
    printk("Error: didn't find %s device\n", SW0_GPIO_LABEL);
    return;
  }
  ret = gpio_pin_configure(dev_button0, SW0_GPIO_PIN, SW0_GPIO_FLAGS);
  if (ret != 0) {
    printk("Error %d: failed to configure %s pin %d\n",
        ret, SW0_GPIO_LABEL, SW0_GPIO_PIN);
    return;
  }
  ret = gpio_pin_interrupt_configure(dev_button0,
      SW0_GPIO_PIN,
      GPIO_INT_EDGE_TO_ACTIVE);
  if (ret != 0) {
    printk("Error %d: failed to configure interrupt on %s pin %d\n",
        ret, SW0_GPIO_LABEL, SW0_GPIO_PIN);
    return;
  }

  gpio_init_callback(&button_cb_data, button_pressed_handler, BIT(SW0_GPIO_PIN));
  gpio_add_callback(dev_button0, &button_cb_data);
  printk("Set up button at %s pin %d\n", SW0_GPIO_LABEL, SW0_GPIO_PIN);
  button0_callback = button0_cb;

  k_work_init_delayable(&buttons_debounce, buttons_debounce_fn);
}



/* Init the Leds */
void bm_init_leds() {
  dev_led0 = device_get_binding(LED0);
  if (dev_led0 == NULL) {
    printk("Error no LED0 found");
    return;
  }
  ret = gpio_pin_configure(dev_led0, PIN_LED0, GPIO_OUTPUT_INACTIVE | FLAGS_LED0);
  if (ret < 0) {
    printk("Error in configuration of led0 pin (err %d)", ret);
    return;
  }
  dev_led1 = device_get_binding(LED1);
  if (dev_led1 == NULL) {
    printk("Error no LED1 found");
    return;
  }
  ret = gpio_pin_configure(dev_led1, PIN_LED1, GPIO_OUTPUT_INACTIVE | FLAGS_LED1);
  if (ret < 0) {
    printk("Error in configuration of led1 pin (err %d)", ret);
    return;
  }
  dev_led2 = device_get_binding(LED2);
  if (dev_led2 == NULL) {
    printk("Error no LED2 found");
    return;
  }
  ret = gpio_pin_configure(dev_led2, PIN_LED2, GPIO_OUTPUT_INACTIVE | FLAGS_LED2);
  if (ret < 0) {
    printk("Error in configuration of led2 pin (err %d)", ret);
    return;
  }
  dev_led3 = device_get_binding(LED3);
  if (dev_led3 == NULL) {
    printk("Error no LED3 found");
    return;
  }
  ret = gpio_pin_configure(dev_led3, PIN_LED3, GPIO_OUTPUT_INACTIVE | FLAGS_LED3);
  if (ret < 0) {
    printk("Error in configuration of led3 pin (err %d)", ret);
    return;
  }
}

/* Init the Switch */
void bm_init_switch() {
  dev_switch = device_get_binding(SWITCH);
  if (dev_switch == NULL) {
    printk("Error no SWITCH found");
    return;
  }
  ret = gpio_pin_configure(dev_switch, PIN_SWITCH, GPIO_OUTPUT_INACTIVE);
  if (ret < 0) {
    printk("Error in configuration of switch pin (err %d)", ret);
    return;
  }
}

/* Set LED0. pca10059 -> Green LED */
void bm_led0_set(bool state) {
  gpio_pin_set(dev_led0, PIN_LED0, (int)state);
  led0_is_on = state;
}

/* Get LED0 */
bool bm_led0_get() {
  return led0_is_on;
}

/* Set LED1. pca10059 -> Red LED (RGB) */
void bm_led1_set(bool state) {
  gpio_pin_set(dev_led1, PIN_LED1, (int)state);
  led1_is_on = state;
}

/* Get LED1 */
bool bm_led1_get() {
  return led1_is_on;
}

/* Set LED2. pca10059 -> Green LED (RGB) */
void bm_led2_set(bool state) {
  gpio_pin_set(dev_led2, PIN_LED2, (int)state);
  led2_is_on = state;
}

/* Get LED2 */
bool bm_led2_get() {
  return led2_is_on;
}

/* Set LED3. pca10059 -> Blue LED (RGB)  */
void bm_led3_set(bool state) {
  gpio_pin_set(dev_led3, PIN_LED3, (int)state);
  led3_is_on = state;
}

/* Get LED3 */
bool bm_led3_get() {
  return led3_is_on;
}

/* Set SWITCH */
void bm_switch_set(bool state) {
  gpio_pin_set(dev_switch, PIN_SWITCH, (int)state);
  switch_is_on = state;
}

/* Get Switch */
bool bm_switch_get() {
  return switch_is_on;
}


/* Get BUTTON0 Toggled State*/
bool bm_button0_toggle_state_get() {
  //gpio_pin_get(dev_led0, PIN_LED0, (int)state);
  return button0_toggel_state;
}

/* Set BUTTON0 Toggled State*/
void bm_button0_toggle_state_set(bool newstate) {
  //gpio_pin_get(dev_led0, PIN_LED0, (int)state);
  button0_toggel_state = newstate;
}
```
