## CMakeLists.txt
```
# SPDX-License-Identifier: Apache-2.0

cmake_minimum_required(VERSION 3.13.1)

#Board selection
set(BOARD nrf52840dk_nrf52840)
#set(BOARD nrf5340pdk_nrf5340_cpunet)
#set(BOARD nrf5340pdk_nrf5340_cpuapp)
#set(BOARD nrf52840dongle_nrf52840)
#set(BOARD nrf52840dk_nrf52811)

find_package(Zephyr REQUIRED HINTS $ENV{ZEPHYR_BASE})
project(gsm_modem)

target_sources(app PRIVATE src/main.c)
```

## Kconfig
```
# Private config options for can sample app

# Copyright (c) 2018 Alexander Wachter
# SPDX-License-Identifier: Apache-2.0

mainmenu "Controller Area Network sample application"

config GSM_PPP_AUTOSTART
	bool "Auto-start PPP at boot"
	default y
	help
	  This setting lets driver connect to network and initialize PPP at
	  boot. Unselect this if you want to run application code before
	  modem connects to network. See contents of "drivers/gsm_ppp.h"
	  to get an idea of the API.

config MODEM_GSM_HAS_SIMPIN
	bool "SIM Card PIN"
	default n
	help
	  If the GSM Modem is secured by a SIM PIN

config MODEM_GSM_SIMPIN
	string "SIM Card PIN"
	default "0000"
	help
	  If the GSM Modem is secured by a SIM PIN enter it as a string

source "Kconfig.zephyr"
```

## prj.conf
```kconfig
# UART support
CONFIG_SERIAL=y

# GSM modem support
CONFIG_MODEM=y
CONFIG_MODEM_GSM_PPP=y
CONFIG_MODEM_GSM_UART_NAME="UART_1"

# PPP networking support
CONFIG_NET_PPP=y
CONFIG_NET_L2_PPP=y
CONFIG_NET_NATIVE=y
CONFIG_NETWORKING=y

CONFIG_NET_L2_PPP_TIMEOUT=10000

# IPv4 enables PPP IPCP support
CONFIG_NET_IPV4=y
CONFIG_NET_IPV6=n

# Network management events
CONFIG_NET_CONNECTION_MANAGER=y

# Log buffers, modem and PPP
CONFIG_LOG=y
CONFIG_NET_LOG=y
#CONFIG_LOG_BUFFER_SIZE=16384
#CONFIG_LOG_STRDUP_BUF_COUNT=200
CONFIG_MODEM_LOG_LEVEL_DBG=y
CONFIG_NET_PPP_LOG_LEVEL_DBG=y
#CONFIG_NET_L2_PPP_LOG_LEVEL_DBG=y
#CONFIG_NET_MGMT_EVENT_LOG_LEVEL_DBG=y
#CONFIG_NET_CONNECTION_MANAGER_LOG_LEVEL_DBG=y

CONFIG_NET_SHELL=y
CONFIG_MODEM_SHELL=y

#Additional Configs
CONFIG_MODEM_GSM_APN="gprs.swisscom.ch"
CONFIG_MODEM_GSM_SIMCOM=y
CONFIG_MODEM_GSM_HAS_SIMPIN=y
CONFIG_MODEM_GSM_SIMPIN="4242"
CONFIG_GSM_PPP_AUTOSTART=n
```

## nrf52840dk_nrf52840.overlay
```dts
&uart1 {
	current-speed = <115200>;
	tx-pin = <12>;
	rx-pin = <14>;
	rts-pin = <16>;
	cts-pin = <18>;
};
```

## src/main.c
```c
/*
 * Copyright (c) 2020, Intel Corporation
 *
 * SPDX-License-Identifier: Apache-2.0
 */

#include <zephyr.h>
#include <sys/printk.h>
#include <shell/shell.h>
#include <drivers/uart.h>
#include <net/net_mgmt.h>
#include <net/net_event.h>
#include <net/net_conn_mgr.h>
#include <drivers/gsm_ppp.h>

#include <logging/log.h>
LOG_MODULE_REGISTER(sample_gsm_ppp, LOG_LEVEL_DBG);

#include <drivers/../../drivers/modem/modem_cmd_handler.h>

static const struct device *gsm_dev;
static struct net_mgmt_event_callback mgmt_cb;
static bool connected;
static bool starting = true;

static int cmd_sample_modem_suspend(const struct shell *shell,
				    size_t argc, char *argv[])
{
	if (!connected) {
		shell_fprintf(shell, SHELL_NORMAL, "Not connected.\n");
		return -ENOEXEC;
	}

	gsm_ppp_stop(gsm_dev);

	return 0;
}

static int cmd_sample_modem_resume(const struct shell *shell,
				   size_t argc, char *argv[])
{
	if (starting) {
		shell_fprintf(shell, SHELL_NORMAL,
			      "Please wait for network connection.\n");
		return -ENOEXEC;
	}

	if (connected) {
		shell_fprintf(shell, SHELL_NORMAL, "Already connected.\n");
		return -ENOEXEC;
	}

	gsm_ppp_start(gsm_dev);

	return 0;
}

SHELL_STATIC_SUBCMD_SET_CREATE(sample_commands,
	SHELL_CMD(resume, NULL,
		  "Resume the modem\n",
		  cmd_sample_modem_resume),
	SHELL_CMD(suspend, NULL,
		  "Suspend the modem\n",
		  cmd_sample_modem_suspend),
	SHELL_SUBCMD_SET_END
);

SHELL_CMD_REGISTER(sample, &sample_commands,
		   "Sample application commands", NULL);


static void event_handler(struct net_mgmt_event_callback *cb,
			  uint32_t mgmt_event, struct net_if *iface)
{
	if ((mgmt_event & (NET_EVENT_L4_CONNECTED
			   | NET_EVENT_L4_DISCONNECTED)) != mgmt_event) {
		return;
	}

	starting = false;

	if (mgmt_event == NET_EVENT_L4_CONNECTED) {
		LOG_INF("Network connected");
		connected = true;
		return;
	}

	if (mgmt_event == NET_EVENT_L4_DISCONNECTED) {
		LOG_INF("Network disconnected");
		connected = false;
		return;
	}
}

int main(void)
{
	const struct device *uart_dev =
				device_get_binding(CONFIG_MODEM_GSM_UART_NAME);

	gsm_dev = device_get_binding(GSM_MODEM_DEVICE_NAME);


	LOG_INF("Board '%s' APN '%s' UART '%s' device %p (%s)",
		CONFIG_BOARD, CONFIG_MODEM_GSM_APN,
		CONFIG_MODEM_GSM_UART_NAME, uart_dev, GSM_MODEM_DEVICE_NAME);

	net_mgmt_init_event_callback(&mgmt_cb, event_handler,
				     NET_EVENT_L4_CONNECTED |
				     NET_EVENT_L4_DISCONNECTED);
	net_mgmt_add_event_callback(&mgmt_cb);

	

	return 0;
}
```
