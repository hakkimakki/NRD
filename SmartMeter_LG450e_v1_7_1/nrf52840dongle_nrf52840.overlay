#include <dt-bindings/gpio/gpio.h>


&spi1 {
     status = "okay";
          sck-pin = <47>; /* 1.15 */
       mosi-pin = <2>;
       miso-pin = <29>;
       cs-gpios = <&gpio1 13 GPIO_ACTIVE_LOW>; /* 1.13 */
  
        lora: sx1276@0 {
         compatible = "semtech,sx1276";
         reg = <0>;
         label = "sx1276";
         reset-gpios = <&gpio0 31 GPIO_ACTIVE_LOW>;
         dio-gpios = <&gpio1 10 (GPIO_PULL_DOWN | GPIO_ACTIVE_HIGH)>,<&gpio0 10 (GPIO_PULL_DOWN | GPIO_ACTIVE_HIGH)>;
         spi-max-frequency = <1000000>;
         power-amplifier-output = "pa-boost";
     };
  
  };
  
  / {
     aliases {
        lora0 = &lora;
   };
  };