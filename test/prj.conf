## CMakeLists.txt
```
cmake_minimum_required(VERSION 3.8.2)

#Board selection inside zephyr
set(BOARD nrf52840dk_nrf52840)
#set(BOARD nrf5340pdk_nrf5340_cpunet)
#set(BOARD nrf5340pdk_nrf5340_cpuapp)
#set(BOARD nrf52840dongle_nrf52840)
#set(BOARD nrf52840dk_nrf52811)
#Board selection outside zephyr
#set(BOARD_ROOT ./board)

#Toolchain selection
#set(TOOLCHAIN C:/gnuarmemb)

#Zephyr selection
set(ZEPHYR_BASE L:/Github/ncs/zephyr)
#set(ZEPHYR_BASE L:/Github/ncs-workspace-1.6.1/zephyr)

find_package(Zephyr REQUIRED HINTS $ENV{ZEPHYR_BASE})

project(NONE)

#Include Simple Zephyr Library
add_subdirectory_ifdef(CONFIG_SZL_ENABLE szl)

# Include all files in folder src
FILE(GLOB app_sources_c src/*.c)
FILE(GLOB app_sources_cpp src/*.cpp)

target_sources(app PRIVATE
	${app_sources_c} ${app_sources_cpp})

target_include_directories(app PRIVATE include)

FILE(GLOB dlms_sources_cpp dlms/src/*.cpp)

target_sources(app PRIVATE ${app_sources_cpp} ${dlms_sources_cpp})

target_include_directories(app PRIVATE dlms/..)
```

## prj.conf
```kconfig
CONFIG_SERIAL=y
CONFIG_STDOUT_CONSOLE=y

CONFIG_SZL_ENABLE=y
CONFIG_SZL_UART_ENABLE=y

CONFIG_LOG=y
CONFIG_LOG_DEFAULT_LEVEL=4
CONFIG_HEAP_MEM_POOL_SIZE=16000
CONFIG_MAIN_STACK_SIZE=16000
CONFIG_NEWLIB_LIBC=y
#CONFIG_NEWLIB_LIBC_MIN_REQUIRED_HEAP_SIZE=32000

CONFIG_CPLUSPLUS=y
CONFIG_LIB_CPLUSPLUS=y
CONFIG_RTTI=y

CONFIG_DEBUG=y
CONFIG_DEBUG_OPTIMIZATIONS=y
CONFIG_TEST=y
CONFIG_ASSERT=y
```

## src/main.cpp
```c
#include <zephyr.h>
#include <stdio.h>
#include "../dlms/include/GXDLMSNotify.h"
#include "../dlms/include/GXDLMSData.h"
//#include "../dlms/include/GXDLMSTranslator.h"




void main(void)
{
    
    printf("Started\n");
    printf("Landys+Gyr E450 Push Listener started\n");

    static int ret;    

    //CGXByteBuffer reply;
    // Client used to parse received data.
    static CGXDLMSClient cl(true, -1, -1, DLMS_AUTHENTICATION_NONE, NULL, DLMS_INTERFACE_TYPE_HDLC);

    static CGXByteBuffer bb;
    ret = bb.Capacity(2048);

    /**
    * Received data. This is used if GBT is used and data is received on
    * several data blocks.
    */
    static CGXReplyData data;
    static CGXReplyData notify;

    /** Frames */
    char const *p1 = "7ea084ceff0313128be6e700e04000010000700f0001d3760c07e5061c010f1b32ff800000020e010e020412002809060008190900ff0f02120000020412002809060008190900ff0f01120000020412000109060000600100ff0f02120000020412000309060100010700ff0f02120000020412000309060100020700ff0f02120000b21a7e";
    char const *p2 = "7ea07dceff0313d045e040000200006c020412000309060101010800ff0f02120000020412000309060101020800ff0f02120000020412000309060101050800ff0f02120000020412000309060101060800ff0f02120000020412000309060101070800ff0f02120000020412000309060101080800ff0f02120000c1957e";
    char const *p3 = "7ea08aceff0313aaeae0c000030000790204120003090601001f0700ff0f02120000020412000309060100330700ff0f02120000020412000309060100470700ff0f0212000009060008190900ff090835363535323737330600000047060000000006000343f20600000000060000209d06000000000600000000060001a02212002412001112001032167e"; 
    bb.SetHexString(p1);
    bb.SetPosition(0);

    /** Parse HDLC Frame */
    if ((ret = cl.GetData(bb, data, notify)) != 0 && ret != DLMS_ERROR_CODE_FALSE)
    {
        printk("Error cl.GetData: %u\n", ret);
    }
    /** Is More Data available */
    printk("Packet Complete: %u\n", notify.IsComplete());
    printk("More Data: %u\n", notify.IsMoreData());
    bb.Clear();

    /** Frame 2 */
    
    bb.SetHexString(p2);
    bb.SetPosition(0);

    /** Parse HDLC Frame */
    if ((ret = cl.GetData(bb, data, notify)) != 0 && ret != DLMS_ERROR_CODE_FALSE)
    {
        printf("Error cl.GetData: %u", ret);
    }
    /** Is More Data available */
    printf("Packet Complete: %u\n", notify.IsComplete());
    printf("More Data: %u\n", notify.IsMoreData());
    bb.Clear();

    /** Frame 3 */
    
    bb.SetHexString(p3);
    bb.SetPosition(0);

    /** Parse HDLC Frame */
    if ((ret = cl.GetData(bb, data, notify)) != 0 && ret != DLMS_ERROR_CODE_FALSE)
    {
        printf("Error cl.GetData: %u", ret);
    }
    /** Is More Data available */
    printf("Packet Complete: %u\n", notify.IsComplete());
    printf("More Data: %u\n", notify.IsMoreData());
    bb.Clear();

    //Example is sending list of push messages in first parameter.
    if (notify.GetValue().vt == DLMS_DATA_TYPE_STRUCTURE)
    {
        std::vector<std::pair<CGXDLMSObject *, unsigned char>> objects;
        ret = cl.ParsePushObjects(notify.GetValue().Arr[0].Arr, objects);
        //Remove first item because it's not needed anymore.
        objects.erase(objects.begin());
        //Update clock.
        int Valueindex = 1;
        std::vector<std::string> values;
        for (std::vector<std::pair<CGXDLMSObject *, unsigned char>>::iterator it = objects.begin(); it != objects.end(); ++it)
        {
            values.clear();
            cl.UpdateValue(*it->first, it->second, notify.GetValue().Arr[Valueindex]);
            ++Valueindex;
            //Print value
            std::string ln;
            it->first->GetLogicalName(ln);
            it->first->GetValues(values);
            printf("%s %s %d: %s\r\n", CGXDLMSConverter::ToString(it->first->GetObjectType()), ln.c_str(), it->second, values.at(it->second - 1).c_str());
        }
    }
    printf("Server address: %d Client Address: %d\r\n", notify.GetServerAddress(), notify.GetClientAddress());
    notify.Clear();
    data.Clear();
    bb.Trim();
    
    printf("Done\n");    
}
```

## src/app_LGe450_Push_Parser.cpp
```c
#include <zephyr.h>
#include <stdio.h>
#include "../dlms/include/GXDLMSNotify.h"
#include "../dlms/include/GXDLMSData.h"
//#include "../dlms/include/GXDLMSTranslator.h"

class app_LGe450_Push_Parser {       
    public:
        app_LGe450_Push_Parser(){
            bb.Capacity(2048);
            bb.Clear();
        }
    private:
        int ret; 
        // Client used to parse received data.
        CGXDLMSClient cl(true, -1, -1, DLMS_AUTHENTICATION_NONE, NULL, DLMS_INTERFACE_TYPE_HDLC);
        CGXByteBuffer bb;
        /**
        * Received data. This is used if GBT is used and data is received on
        * several data blocks.
        */
        CGXReplyData data;
        CGXReplyData notify;
};

// Method/function definition outside the class
void app_LGe450_Push_Parser::parse(const void* pSource, unsigned long count) {
    bb.set(pSource,count);
    /** Parse HDLC Frame */
    if ((ret = cl.GetData(bb, data, notify)) != 0 && ret != DLMS_ERROR_CODE_FALSE)
    {
        printk("Error cl.GetData: %u\n", ret);
    }
    /** Is More Data available */
    printk("Packet Complete: %u\n", notify.IsComplete());
    printk("More Data: %u\n", notify.IsMoreData());
    bb.Clear();
    //All Data Received
    if((notify.IsMoreData() == 0) && (notify.IsComplete() == 1)){
        //Example is sending list of push messages in first parameter.
        if (notify.GetValue().vt == DLMS_DATA_TYPE_STRUCTURE)
        {
            std::vector<std::pair<CGXDLMSObject *, unsigned char>> objects;
            ret = cl.ParsePushObjects(notify.GetValue().Arr[0].Arr, objects);
            //Remove first item because it's not needed anymore.
            objects.erase(objects.begin());
            //Update clock.
            int Valueindex = 1;
            std::vector<std::string> values;
            for (std::vector<std::pair<CGXDLMSObject *, unsigned char>>::iterator it = objects.begin(); it != objects.end(); ++it)
            {
                values.clear();
                cl.UpdateValue(*it->first, it->second, notify.GetValue().Arr[Valueindex]);
                ++Valueindex;
                //Print value
                std::string ln;
                it->first->GetLogicalName(ln);
                it->first->GetValues(values);
                printf("%s %s %d: %s\r\n", CGXDLMSConverter::ToString(it->first->GetObjectType()), ln.c_str(), it->second, values.at(it->second - 1).c_str());
            }
        }
        printf("Server address: %d Client Address: %d\r\n", notify.GetServerAddress(), notify.GetClientAddress());
        notify.Clear();
        data.Clear();
        bb.Trim();
        
        printf("Done\n");
    }    
}
```
