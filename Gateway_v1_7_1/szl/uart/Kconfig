## Gateway_v1_7_1/szl/uart/Kconfig
```kconfig
config SZL_UART_ENABLE
	bool "Enable SZL_UART"
	default n
	depends on SZL_ENABLE
	depends on SERIAL_SUPPORT_INTERRUPT
	select UART_INTERRUPT_DRIVEN
	select RING_BUFFER

config SZL_UART_MAX_CONTEXTS
	int "Maximum Number of SZL UART Contexts"
	default 3
	depends on SZL_UART_ENABLE

config SZL_UART_RX_RING_BUF_LEN
	int "Size of Receive Ring Buffer"
	default 255
	depends on SZL_UART_ENABLE
```

## LightSwitch_RemoteControl_v1_8_0/boards/arm/skb501_nrf52840/Kconfig.defconfig
```kconfig
# nRF52840 DK NRF52840 board configuration

# Copyright (c) 2016 Nordic Semiconductor ASA
# SPDX-License-Identifier: Apache-2.0

if BOARD_SKB501_NRF52840

config BOARD
	default "skb501_nrf52840"

config BT_CTLR
	default BT

endif # BOARD_SKB501_NRF52840
```

## LightSwitch_RemoteControl_v1_8_0/build_1/Kconfig/Kconfig.modules
```kconfig
menu "nrf (C:\Users\raffa\Github\ncs\nrf)"
osource "C:/Users/raffa/Github/ncs/nrf/Kconfig.nrf"
config ZEPHYR_NRF_MODULE
	bool
	default y
endmenu
menu "mcuboot (C:\Users\raffa\Github\ncs\bootloader\mcuboot)"
osource "$(ZEPHYR_MCUBOOT_KCONFIG)"
config ZEPHYR_MCUBOOT_MODULE
	bool
	default y
endmenu
menu "trusted-firmware-m (C:\Users\raffa\Github\ncs\modules\tee\tfm)"
osource "$(ZEPHYR_TRUSTED_FIRMWARE_M_KCONFIG)"
config ZEPHYR_TRUSTED_FIRMWARE_M_MODULE
	bool
	default y
endmenu
menu "cjson (C:\Users\raffa\Github\ncs\modules\lib\cjson)"
osource "$(ZEPHYR_CJSON_KCONFIG)"
config ZEPHYR_CJSON_MODULE
	bool
	default y
endmenu
menu "pelion-dm (C:\Users\raffa\Github\ncs\modules\lib\pelion-dm)"
osource "C:/Users/raffa/Github/ncs/modules/lib/pelion-dm/zephyr/Kconfig"
config ZEPHYR_PELION_DM_MODULE
	bool
	default y
endmenu
menu "cddl-gen (C:\Users\raffa\Github\ncs\modules\lib\cddl-gen)"
osource "$(ZEPHYR_CDDL_GEN_KCONFIG)"
config ZEPHYR_CDDL_GEN_MODULE
	bool
	default y
endmenu
menu "memfault-firmware-sdk (C:\Users\raffa\Github\ncs\modules\lib\memfault-firmware-sdk)"
osource "C:/Users/raffa/Github/ncs/modules/lib/memfault-firmware-sdk/ports/zephyr/Kconfig"
config ZEPHYR_MEMFAULT_FIRMWARE_SDK_MODULE
	bool
	default y
endmenu
menu "CANopenNode (C:\Users\raffa\Github\ncs\modules\lib\canopennode)"
osource "$(ZEPHYR_CANOPENNODE_KCONFIG)"
config ZEPHYR_CANOPENNODE_MODULE
	bool
	default y
endmenu
menu "hal_nordic (C:\Users\raffa\Github\ncs\modules\hal\nordic)"
osource "$(ZEPHYR_HAL_NORDIC_KCONFIG)"
config ZEPHYR_HAL_NORDIC_MODULE
	bool
	default y
endmenu
menu "loramac-node (C:\Users\raffa\Github\ncs\modules\lib\loramac-node)"
osource "$(ZEPHYR_LORAMAC_NODE_KCONFIG)"
config ZEPHYR_LORAMAC_NODE_MODULE
	bool
	default y
endmenu
menu "lz4 (C:\Users\raffa\Github\ncs\modules\lib\lz4)"
osource "$(ZEPHYR_LZ4_KCONFIG)"
config ZEPHYR_LZ4_MODULE
	bool
	default y
endmenu
menu "mbedtls (C:\Users\raffa\Github\ncs\modules\crypto\mbedtls)"
osource "$(ZEPHYR_MBEDTLS_KCONFIG)"
config ZEPHYR_MBEDTLS_MODULE
	bool
	default y
endmenu
menu "nanopb (C:\Users\raffa\Github\ncs\modules\lib\nanopb)"
osource "$(ZEPHYR_NANOPB_KCONFIG)"
config ZEPHYR_NANOPB_MODULE
	bool
	default y
endmenu
menu "TraceRecorder (C:\Users\raffa\Github\ncs\modules\debug\TraceRecorder)"
osource "C:/Users/raffa/Github/ncs/modules/debug/TraceRecorder/kernelports/Zephyr/Kconfig"
config ZEPHYR_TRACERECORDER_MODULE
	bool
	default y
endmenu
menu "nrfxlib (C:\Users\raffa\Github\ncs\nrfxlib)"
osource "C:/Users/raffa/Github/ncs/nrfxlib/Kconfig.nrfxlib"
config ZEPHYR_NRFXLIB_MODULE
	bool
	default y
endmenu
menu "connectedhomeip (C:\Users\raffa\Github\ncs\modules\lib\matter)"
osource "C:/Users/raffa/Github/ncs/modules/lib/matter/config/nrfconnect/chip-module/Kconfig"
config ZEPHYR_CONNECTEDHOMEIP_MODULE
	bool
	default y
endmenu
```

## Mesh_Sensor_Client_div_v1_5_0/szl/usb_cdc_acm/Kconfig
```kconfig
config SZL_USB_CDC_ACM_ENABLE
	bool "Enable SZL_USB_CDC_ACM"
	default n
	select SERIAL
	select USB
	select USB_UART_CONSOLE
	select STDOUT_CONSOLE
	select USB_DEVICE_STACK
	
```

## OLD/SmartMeter_LGe450_v1_6_1/szl/usb_cdc_acm/Kconfig
```kconfig
config SZL_USB_CDC_ACM_ENABLE
	bool "Enable SZL_USB_CDC_ACM"
	default n
	select USB
	select USB_DEVICE_STACK
	select USB_UART_CONSOLE
	select UART_INTERRUPT_DRIVEN
	select UART_LINE_CTRL

config UART_CONSOLE_ON_DEV_NAME
	string "Default override to CDC_ACM_0"
	default "CDC_ACM_0"
	
	
```

## SVM30_Mesh_Sensor_Server_Dongle_v1_5_0/build/Kconfig/Kconfig.shield
```kconfig
osource "D:/Raffael/GitHub/P6_Software_local/ncs/nrf/boards/shields/*/Kconfig.shield"
osource "D:/Raffael/GitHub/P6_Software_local/ncs/zephyr/boards/shields/*/Kconfig.shield"
osource "D:/Raffael/GitHub/P6_Software_local/ncs/zephyr/boards/shields/*/Kconfig.shield"
```

## SmartMeter_LGe450_v1_6_1/szl/LoRa/Kconfig
```kconfig
config SZL_LORA_ENABLE
	bool "Enable SZL_LORA"
	default n
	select LOG
	select SPI
	select GPIO
	select LORA
	select LORA_SX12XX
	select PRINTK
	
```

## SmartMeter_LGe450_v1_6_1/szl/influxdb/Kconfig
```kconfig
config SZL_INFLUXDB_ENABLE
	bool "Enable SZL_INFLUXDB"
	default n
	select CONFIG_NEWLIB_LIBC
	select CONFIG_NEWLIB_LIBC_FLOAT_PRINTF
	
```

## dlms_test_v1_7_0/szl/usb_cdc_acm/Kconfig
```kconfig
config SZL_USB_CDC_ACM_ENABLE
	bool "Enable SZL_USB_CDC_ACM"
	default n
	select CONFIG_SERIAL
	select CONFIG_USB_UART_CONSOLE
	select USB_UART_CONSOLE
	select CONFIG_STDOUT_CONSOLE
	select USB_DEVICE_STACK
	
```

## light_Funksteckdose_v1_5_0/build/Kconfig/Kconfig.modules
```kconfig
menu "nrf (D:\Raffael\GitHub\P6_Software_local\ncs\nrf)"
osource "D:/Raffael/GitHub/P6_Software_local/ncs/nrf/Kconfig.nrf"
config ZEPHYR_NRF_MODULE
	bool
	default y
endmenu
menu "mcuboot (D:\Raffael\GitHub\P6_Software_local\ncs\bootloader\mcuboot)"
osource "$(ZEPHYR_MCUBOOT_KCONFIG)"
config ZEPHYR_MCUBOOT_MODULE
	bool
	default y
endmenu
menu "nrfxlib (D:\Raffael\GitHub\P6_Software_local\ncs\nrfxlib)"
osource "D:/Raffael/GitHub/P6_Software_local/ncs/nrfxlib/Kconfig.nrfxlib"
config ZEPHYR_NRFXLIB_MODULE
	bool
	default y
endmenu
menu "cddl-gen (D:\Raffael\GitHub\P6_Software_local\ncs\modules\lib\cddl-gen)"
osource "$(ZEPHYR_CDDL_GEN_KCONFIG)"
config ZEPHYR_CDDL_GEN_MODULE
	bool
	default y
endmenu
menu "hal_nordic (D:\Raffael\GitHub\P6_Software_local\ncs\modules\hal\nordic)"
osource "$(ZEPHYR_HAL_NORDIC_KCONFIG)"
config ZEPHYR_HAL_NORDIC_MODULE
	bool
	default y
endmenu
menu "connectedhomeip (D:\Raffael\GitHub\P6_Software_local\ncs\modules\lib\connectedhomeip)"
osource "D:/Raffael/GitHub/P6_Software_local/ncs/modules/lib/connectedhomeip/config/nrfconnect/chip-module/Kconfig"
config ZEPHYR_CONNECTEDHOMEIP_MODULE
	bool
	default y
endmenu
```

## sht3xd_LoRa_Mesh_Sensor_Server_LPN_Dongle_v1_5_0/build/Kconfig/Kconfig.soc.arch
```kconfig
osource "D:/Raffael/GitHub/P6_Software_local/ncs/zephyr/soc/$(ARCH)/Kconfig"
osource "D:/Raffael/GitHub/P6_Software_local/ncs/zephyr/soc/$(ARCH)/*/Kconfig"
```

## sht3xd_LoRa_Sender_Mesh_v1_5_0/build/Kconfig/Kconfig.shield.defconfig
```kconfig
osource "D:/Raffael/GitHub/P6_Software_local/ncs/nrf/boards/shields/*/Kconfig.defconfig"
osource "D:/Raffael/GitHub/P6_Software_local/ncs/zephyr/boards/shields/*/Kconfig.defconfig"
osource "D:/Raffael/GitHub/P6_Software_local/ncs/zephyr/boards/shields/*/Kconfig.defconfig"
```

## sht3xd_LoRa_Sender_Mesh_v1_5_0/build/Kconfig/Kconfig.soc
```kconfig
osource "D:/Raffael/GitHub/P6_Software_local/ncs/zephyr/soc/$(ARCH)/*/Kconfig.soc"
```

## test/szl/Kconfig
```kconfig
config SZL_ENABLE
   bool "Enable Simple Zephyr Library"
   default y

rsource "*/Kconfig"
```
