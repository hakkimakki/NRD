## CMakeLists.txt
```
#
# Copyright (c) 2019 Nordic Semiconductor ASA
#
# SPDX-License-Identifier: LicenseRef-BSD-5-Clause-Nordic
#
cmake_minimum_required(VERSION 3.8.2)

#Board selection
set(BOARD nrf52840dk_nrf52840)
#set(BOARD nrf5340pdk_nrf5340_cpunet)
#set(BOARD nrf5340pdk_nrf5340_cpuapp)
#set(BOARD nrf52840dongle_nrf52840)
#set(BOARD nrf52840dk_nrf52811)

find_package(Zephyr REQUIRED HINTS $ENV{ZEPHYR_BASE})
project(NONE)

# Include all files in folder src
FILE(GLOB app_sources_c src/*.c)
#FILE(GLOB dlms_sources_c dlms/src/*.c)
#FILE(GLOB dlms_sources_h dlms/include/*.h)
FILE(GLOB app_sources_cpp src/*.cpp)

target_sources(app PRIVATE
	${app_sources_c}
	${app_sources_cpp}
	#${dlms_sources_c}
	#${dlms_sources_h}
	dlms/src/client.c dlms/include/gxignore.h dlms/src/apdu.c dlms/src/bitarray.c dlms/src/bytebuffer.c dlms/src/ciphering.c dlms/src/converters.c dlms/src/cosem.c dlms/src/datainfo.c 
	dlms/src/date.c 
	dlms/src/dlms.c dlms/src/dlmsSettings.c dlms/src/gxaes.c dlms/src/gxarray.c dlms/src/gxget.c dlms/src/gxinvoke.c dlms/src/gxkey.c dlms/src/gxmd5.c dlms/src/gxobjects.c dlms/src/gxset.c dlms/src/gxsha1.c dlms/src/gxsha256.c dlms/src/gxvalueeventargs.c dlms/src/helpers.c dlms/src/message.c dlms/src/notify.c dlms/src/objectarray.c dlms/src/parameters.c dlms/src/replydata.c dlms/src/server.c dlms/src/variant.c
	)

target_include_directories(app PRIVATE include)
```

## prj.conf
```kconfig
#
# Copyright (c) 2019 Nordic Semiconductor ASA
#
# SPDX-License-Identifier: LicenseRef-BSD-5-Clause-Nordic
#

CONFIG_SERIAL=y
CONFIG_STDOUT_CONSOLE=y

#For DLMS
CONFIG_NEWLIB_LIBC=y

#For Reset
CONFIG_REBOOT=y

#For nRF52 Dongle (enable if flashed over USB / Disable if FLashed over SWD)
#CONFIG_BOARD_HAS_NRF5_BOOTLOADER=y
```

## src/main.c
```c
#include "bm_simple_buttons_and_leds.h"
#include <zephyr.h>
#include <sys/reboot.h>
#include "../dlms/include/client.h"

#include "../dlms/include/dlmssettings.h"
#include "../dlms/include/variant.h"
#include "../dlms/include/cosem.h"
#include "../dlms/include/server.h"


#include <stdio.h>

static gxClock clock1;
static long started;

long time_current(void)
{
  //Get current time.
  //Because there is no clock, clock object keeps base time and uptime is added to that.
  return time_toUnixTime(&clock1.time.value) + (k_uptime_get() - started) / 1000;
}

long time_elapsed(void)
{
  return k_uptime_get();
}



void time_now(
gxtime* value)
{
  long offset = time_current();
  time_initUnix(value, offset);
}


void reset(){
  printk("Reboot now!\n");
  sys_reboot(SYS_REBOOT_COLD);
}


/**@brief Function for application main entry.
 */
void main(void) {
  // Start Application
  printk("Starting Application...\n");
  // Init MAC Address
  uint32_t LSB_MAC_Address = NRF_FICR->DEVICEADDR[0];
  printk("Preprogrammed Randomly Static MAC-Address (LSB): 0x%x, %u \n", LSB_MAC_Address, LSB_MAC_Address);
  // Init Leds
  bm_init_leds();
  //Init Reset Buttons
  bm_init_buttons(reset);
  dlmsSettings settings;
  char hexstring[] = "0F0001D3760C07E5061C010F1B32FF800000020E010E020412002809060008190900FF0F02120000020412002809060008190900FF0F01120000020412000109060000600100FF0F02120000020412000309060100010700FF0F02120000020412000309060100020700FF0F02120000020412000309060101010800FF0F02120000020412000309060101020800FF0F02120000020412000309060101050800FF0F02120000020412000309060101060800FF0F02120000020412000309060101070800FF0F02120000020412000309060101080800FF0F021200000204120003090601001F0700FF0F02120000020412000309060100330700FF0F02120000020412000309060100470700FF0F0212000009060008190900FF090835363535323737330600000047060000000006000343F20600000000060000209D06000000000600000000060001A022120024120011120010";
  char *pos = hexstring;
  unsigned char val[sizeof(hexstring)];

       /* WARNING: no sanitization or error-checking whatsoever */
    for (size_t count = 0; count < sizeof val/sizeof *val; count++) {
        sscanf(pos, "%2hhx", &val[count]);
        pos += 2;
    }

    printf("0x");
    for(size_t count = 0; count < sizeof val/sizeof *val; count++)
        printf("%02x", val[count]);
    printf("\n");

  gxByteBuffer bb;
  bb_attach(&bb,val,sizeof(hexstring),sizeof(hexstring)+10);


  cl_parseObjects(&settings,&bb);
  
}
```
